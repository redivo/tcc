#ifndef PC_COMPILATION
#include <arch/nxp/lpc23xx.h>
#endif
#include "errors.h"
#include "hw_debug.h"
#include "debug.h"

int hw_dbg_get_reg(bool write, char *dbg_str, int value)
{
#ifdef DEBUG_MODE
#ifndef PC_COMPILATION
	if (dbg_str == NULL)
		return ERR_INVALID_PARAM;

	if (strcmp(dbg_str, "VIC_BASE_ADDR") == 0) { if (write) { return ERR_INVALID_PARAM; } return VIC_BASE_ADDR; }
	else if (strcmp(dbg_str, "VICIRQStatus") == 0) { if (write) { VICIRQStatus = value; } return VICIRQStatus; }
	else if (strcmp(dbg_str, "VICFIQStatus") == 0) { if (write) { VICFIQStatus = value; } return VICFIQStatus; }
	else if (strcmp(dbg_str, "VICRawIntr") == 0) { if (write) { VICRawIntr = value; } return VICRawIntr; }
	else if (strcmp(dbg_str, "VICIntSelect") == 0) { if (write) { VICIntSelect = value; } return VICIntSelect; }
	else if (strcmp(dbg_str, "VICIntEnable") == 0) { if (write) { VICIntEnable = value; } return VICIntEnable; }
	else if (strcmp(dbg_str, "VICIntEnClr") == 0) { if (write) { VICIntEnClr = value; } return VICIntEnClr; }
	else if (strcmp(dbg_str, "VICSoftInt") == 0) { if (write) { VICSoftInt = value; } return VICSoftInt; }
	else if (strcmp(dbg_str, "VICSoftIntClr") == 0) { if (write) { VICSoftIntClr = value; } return VICSoftIntClr; }
	else if (strcmp(dbg_str, "VICProtection") == 0) { if (write) { VICProtection = value; } return VICProtection; }
	else if (strcmp(dbg_str, "VICSWPrioMask") == 0) { if (write) { VICSWPrioMask = value; } return VICSWPrioMask; }
	else if (strcmp(dbg_str, "VICVectAddr0") == 0) { if (write) { VICVectAddr0 = value; } return VICVectAddr0; }
	else if (strcmp(dbg_str, "VICVectAddr1") == 0) { if (write) { VICVectAddr1 = value; } return VICVectAddr1; }
	else if (strcmp(dbg_str, "VICVectAddr2") == 0) { if (write) { VICVectAddr2 = value; } return VICVectAddr2; }
	else if (strcmp(dbg_str, "VICVectAddr3") == 0) { if (write) { VICVectAddr3 = value; } return VICVectAddr3; }
	else if (strcmp(dbg_str, "VICVectAddr4") == 0) { if (write) { VICVectAddr4 = value; } return VICVectAddr4; }
	else if (strcmp(dbg_str, "VICVectAddr5") == 0) { if (write) { VICVectAddr5 = value; } return VICVectAddr5; }
	else if (strcmp(dbg_str, "VICVectAddr6") == 0) { if (write) { VICVectAddr6 = value; } return VICVectAddr6; }
	else if (strcmp(dbg_str, "VICVectAddr7") == 0) { if (write) { VICVectAddr7 = value; } return VICVectAddr7; }
	else if (strcmp(dbg_str, "VICVectAddr8") == 0) { if (write) { VICVectAddr8 = value; } return VICVectAddr8; }
	else if (strcmp(dbg_str, "VICVectAddr9") == 0) { if (write) { VICVectAddr9 = value; } return VICVectAddr9; }
	else if (strcmp(dbg_str, "VICVectAddr10") == 0) { if (write) { VICVectAddr10 = value; } return VICVectAddr10; }
	else if (strcmp(dbg_str, "VICVectAddr11") == 0) { if (write) { VICVectAddr11 = value; } return VICVectAddr11; }
	else if (strcmp(dbg_str, "VICVectAddr12") == 0) { if (write) { VICVectAddr12 = value; } return VICVectAddr12; }
	else if (strcmp(dbg_str, "VICVectAddr13") == 0) { if (write) { VICVectAddr13 = value; } return VICVectAddr13; }
	else if (strcmp(dbg_str, "VICVectAddr14") == 0) { if (write) { VICVectAddr14 = value; } return VICVectAddr14; }
	else if (strcmp(dbg_str, "VICVectAddr15") == 0) { if (write) { VICVectAddr15 = value; } return VICVectAddr15; }
	else if (strcmp(dbg_str, "VICVectAddr16") == 0) { if (write) { VICVectAddr16 = value; } return VICVectAddr16; }
	else if (strcmp(dbg_str, "VICVectAddr17") == 0) { if (write) { VICVectAddr17 = value; } return VICVectAddr17; }
	else if (strcmp(dbg_str, "VICVectAddr18") == 0) { if (write) { VICVectAddr18 = value; } return VICVectAddr18; }
	else if (strcmp(dbg_str, "VICVectAddr19") == 0) { if (write) { VICVectAddr19 = value; } return VICVectAddr19; }
	else if (strcmp(dbg_str, "VICVectAddr20") == 0) { if (write) { VICVectAddr20 = value; } return VICVectAddr20; }
	else if (strcmp(dbg_str, "VICVectAddr21") == 0) { if (write) { VICVectAddr21 = value; } return VICVectAddr21; }
	else if (strcmp(dbg_str, "VICVectAddr22") == 0) { if (write) { VICVectAddr22 = value; } return VICVectAddr22; }
	else if (strcmp(dbg_str, "VICVectAddr23") == 0) { if (write) { VICVectAddr23 = value; } return VICVectAddr23; }
	else if (strcmp(dbg_str, "VICVectAddr24") == 0) { if (write) { VICVectAddr24 = value; } return VICVectAddr24; }
	else if (strcmp(dbg_str, "VICVectAddr25") == 0) { if (write) { VICVectAddr25 = value; } return VICVectAddr25; }
	else if (strcmp(dbg_str, "VICVectAddr26") == 0) { if (write) { VICVectAddr26 = value; } return VICVectAddr26; }
	else if (strcmp(dbg_str, "VICVectAddr27") == 0) { if (write) { VICVectAddr27 = value; } return VICVectAddr27; }
	else if (strcmp(dbg_str, "VICVectAddr28") == 0) { if (write) { VICVectAddr28 = value; } return VICVectAddr28; }
	else if (strcmp(dbg_str, "VICVectAddr29") == 0) { if (write) { VICVectAddr29 = value; } return VICVectAddr29; }
	else if (strcmp(dbg_str, "VICVectAddr30") == 0) { if (write) { VICVectAddr30 = value; } return VICVectAddr30; }
	else if (strcmp(dbg_str, "VICVectAddr31") == 0) { if (write) { VICVectAddr31 = value; } return VICVectAddr31; }
	else if (strcmp(dbg_str, "VICVectCntl0") == 0) { if (write) { VICVectCntl0 = value; } return VICVectCntl0; }
	else if (strcmp(dbg_str, "VICVectCntl1") == 0) { if (write) { VICVectCntl1 = value; } return VICVectCntl1; }
	else if (strcmp(dbg_str, "VICVectCntl2") == 0) { if (write) { VICVectCntl2 = value; } return VICVectCntl2; }
	else if (strcmp(dbg_str, "VICVectCntl3") == 0) { if (write) { VICVectCntl3 = value; } return VICVectCntl3; }
	else if (strcmp(dbg_str, "VICVectCntl4") == 0) { if (write) { VICVectCntl4 = value; } return VICVectCntl4; }
	else if (strcmp(dbg_str, "VICVectCntl5") == 0) { if (write) { VICVectCntl5 = value; } return VICVectCntl5; }
	else if (strcmp(dbg_str, "VICVectCntl6") == 0) { if (write) { VICVectCntl6 = value; } return VICVectCntl6; }
	else if (strcmp(dbg_str, "VICVectCntl7") == 0) { if (write) { VICVectCntl7 = value; } return VICVectCntl7; }
	else if (strcmp(dbg_str, "VICVectCntl8") == 0) { if (write) { VICVectCntl8 = value; } return VICVectCntl8; }
	else if (strcmp(dbg_str, "VICVectCntl9") == 0) { if (write) { VICVectCntl9 = value; } return VICVectCntl9; }
	else if (strcmp(dbg_str, "VICVectCntl10") == 0) { if (write) { VICVectCntl10 = value; } return VICVectCntl10; }
	else if (strcmp(dbg_str, "VICVectCntl11") == 0) { if (write) { VICVectCntl11 = value; } return VICVectCntl11; }
	else if (strcmp(dbg_str, "VICVectCntl12") == 0) { if (write) { VICVectCntl12 = value; } return VICVectCntl12; }
	else if (strcmp(dbg_str, "VICVectCntl13") == 0) { if (write) { VICVectCntl13 = value; } return VICVectCntl13; }
	else if (strcmp(dbg_str, "VICVectCntl14") == 0) { if (write) { VICVectCntl14 = value; } return VICVectCntl14; }
	else if (strcmp(dbg_str, "VICVectCntl15") == 0) { if (write) { VICVectCntl15 = value; } return VICVectCntl15; }
	else if (strcmp(dbg_str, "VICVectCntl16") == 0) { if (write) { VICVectCntl16 = value; } return VICVectCntl16; }
	else if (strcmp(dbg_str, "VICVectCntl17") == 0) { if (write) { VICVectCntl17 = value; } return VICVectCntl17; }
	else if (strcmp(dbg_str, "VICVectCntl18") == 0) { if (write) { VICVectCntl18 = value; } return VICVectCntl18; }
	else if (strcmp(dbg_str, "VICVectCntl19") == 0) { if (write) { VICVectCntl19 = value; } return VICVectCntl19; }
	else if (strcmp(dbg_str, "VICVectCntl20") == 0) { if (write) { VICVectCntl20 = value; } return VICVectCntl20; }
	else if (strcmp(dbg_str, "VICVectCntl21") == 0) { if (write) { VICVectCntl21 = value; } return VICVectCntl21; }
	else if (strcmp(dbg_str, "VICVectCntl22") == 0) { if (write) { VICVectCntl22 = value; } return VICVectCntl22; }
	else if (strcmp(dbg_str, "VICVectCntl23") == 0) { if (write) { VICVectCntl23 = value; } return VICVectCntl23; }
	else if (strcmp(dbg_str, "VICVectCntl24") == 0) { if (write) { VICVectCntl24 = value; } return VICVectCntl24; }
	else if (strcmp(dbg_str, "VICVectCntl25") == 0) { if (write) { VICVectCntl25 = value; } return VICVectCntl25; }
	else if (strcmp(dbg_str, "VICVectCntl26") == 0) { if (write) { VICVectCntl26 = value; } return VICVectCntl26; }
	else if (strcmp(dbg_str, "VICVectCntl27") == 0) { if (write) { VICVectCntl27 = value; } return VICVectCntl27; }
	else if (strcmp(dbg_str, "VICVectCntl28") == 0) { if (write) { VICVectCntl28 = value; } return VICVectCntl28; }
	else if (strcmp(dbg_str, "VICVectCntl29") == 0) { if (write) { VICVectCntl29 = value; } return VICVectCntl29; }
	else if (strcmp(dbg_str, "VICVectCntl30") == 0) { if (write) { VICVectCntl30 = value; } return VICVectCntl30; }
	else if (strcmp(dbg_str, "VICVectCntl31") == 0) { if (write) { VICVectCntl31 = value; } return VICVectCntl31; }
	else if (strcmp(dbg_str, "VICVectAddr") == 0) { if (write) { VICVectAddr = value; } return VICVectAddr; }
	else if (strcmp(dbg_str, "PINSEL_BASE_ADDR") == 0) { if (write) { return ERR_INVALID_PARAM; } return PINSEL_BASE_ADDR; }
	else if (strcmp(dbg_str, "PINSEL0") == 0) { if (write) { PINSEL0 = value; } return PINSEL0; }
	else if (strcmp(dbg_str, "PINSEL1") == 0) { if (write) { PINSEL1 = value; } return PINSEL1; }
	else if (strcmp(dbg_str, "PINSEL2") == 0) { if (write) { PINSEL2 = value; } return PINSEL2; }
	else if (strcmp(dbg_str, "PINSEL3") == 0) { if (write) { PINSEL3 = value; } return PINSEL3; }
	else if (strcmp(dbg_str, "PINSEL4") == 0) { if (write) { PINSEL4 = value; } return PINSEL4; }
	else if (strcmp(dbg_str, "PINSEL5") == 0) { if (write) { PINSEL5 = value; } return PINSEL5; }
	else if (strcmp(dbg_str, "PINSEL6") == 0) { if (write) { PINSEL6 = value; } return PINSEL6; }
	else if (strcmp(dbg_str, "PINSEL7") == 0) { if (write) { PINSEL7 = value; } return PINSEL7; }
	else if (strcmp(dbg_str, "PINSEL8") == 0) { if (write) { PINSEL8 = value; } return PINSEL8; }
	else if (strcmp(dbg_str, "PINSEL9") == 0) { if (write) { PINSEL9 = value; } return PINSEL9; }
	else if (strcmp(dbg_str, "PINSEL10") == 0) { if (write) { PINSEL10 = value; } return PINSEL10; }
	else if (strcmp(dbg_str, "PINMODE0") == 0) { if (write) { PINMODE0 = value; } return PINMODE0; }
	else if (strcmp(dbg_str, "PINMODE1") == 0) { if (write) { PINMODE1 = value; } return PINMODE1; }
	else if (strcmp(dbg_str, "PINMODE2") == 0) { if (write) { PINMODE2 = value; } return PINMODE2; }
	else if (strcmp(dbg_str, "PINMODE3") == 0) { if (write) { PINMODE3 = value; } return PINMODE3; }
	else if (strcmp(dbg_str, "PINMODE4") == 0) { if (write) { PINMODE4 = value; } return PINMODE4; }
	else if (strcmp(dbg_str, "PINMODE5") == 0) { if (write) { PINMODE5 = value; } return PINMODE5; }
	else if (strcmp(dbg_str, "PINMODE6") == 0) { if (write) { PINMODE6 = value; } return PINMODE6; }
	else if (strcmp(dbg_str, "PINMODE7") == 0) { if (write) { PINMODE7 = value; } return PINMODE7; }
	else if (strcmp(dbg_str, "PINMODE8") == 0) { if (write) { PINMODE8 = value; } return PINMODE8; }
	else if (strcmp(dbg_str, "PINMODE9") == 0) { if (write) { PINMODE9 = value; } return PINMODE9; }
	else if (strcmp(dbg_str, "GPIO_BASE_ADDR") == 0) { if (write) { return ERR_INVALID_PARAM; } return GPIO_BASE_ADDR; }
	else if (strcmp(dbg_str, "IOPIN0") == 0) { if (write) { IOPIN0 = value; } return IOPIN0; }
	else if (strcmp(dbg_str, "IOSET0") == 0) { if (write) { IOSET0 = value; } return IOSET0; }
	else if (strcmp(dbg_str, "IODIR0") == 0) { if (write) { IODIR0 = value; } return IODIR0; }
	else if (strcmp(dbg_str, "IOCLR0") == 0) { if (write) { IOCLR0 = value; } return IOCLR0; }
	else if (strcmp(dbg_str, "IOPIN1") == 0) { if (write) { IOPIN1 = value; } return IOPIN1; }
	else if (strcmp(dbg_str, "IOSET1") == 0) { if (write) { IOSET1 = value; } return IOSET1; }
	else if (strcmp(dbg_str, "IODIR1") == 0) { if (write) { IODIR1 = value; } return IODIR1; }
	else if (strcmp(dbg_str, "IOCLR1") == 0) { if (write) { IOCLR1 = value; } return IOCLR1; }
	else if (strcmp(dbg_str, "IO0_INT_EN_R") == 0) { if (write) { IO0_INT_EN_R = value; } return IO0_INT_EN_R; }
	else if (strcmp(dbg_str, "IO0_INT_EN_F") == 0) { if (write) { IO0_INT_EN_F = value; } return IO0_INT_EN_F; }
	else if (strcmp(dbg_str, "IO0_INT_STAT_R") == 0) { if (write) { IO0_INT_STAT_R = value; } return IO0_INT_STAT_R; }
	else if (strcmp(dbg_str, "IO0_INT_STAT_F") == 0) { if (write) { IO0_INT_STAT_F = value; } return IO0_INT_STAT_F; }
	else if (strcmp(dbg_str, "IO0_INT_CLR") == 0) { if (write) { IO0_INT_CLR = value; } return IO0_INT_CLR; }
	else if (strcmp(dbg_str, "IO2_INT_EN_R") == 0) { if (write) { IO2_INT_EN_R = value; } return IO2_INT_EN_R; }
	else if (strcmp(dbg_str, "IO2_INT_EN_F") == 0) { if (write) { IO2_INT_EN_F = value; } return IO2_INT_EN_F; }
	else if (strcmp(dbg_str, "IO2_INT_STAT_R") == 0) { if (write) { IO2_INT_STAT_R = value; } return IO2_INT_STAT_R; }
	else if (strcmp(dbg_str, "IO2_INT_STAT_F") == 0) { if (write) { IO2_INT_STAT_F = value; } return IO2_INT_STAT_F; }
	else if (strcmp(dbg_str, "IO2_INT_CLR") == 0) { if (write) { IO2_INT_CLR = value; } return IO2_INT_CLR; }
	else if (strcmp(dbg_str, "IO_INT_STAT") == 0) { if (write) { IO_INT_STAT = value; } return IO_INT_STAT; }
	else if (strcmp(dbg_str, "PARTCFG_BASE_ADDR") == 0) { if (write) { return ERR_INVALID_PARAM; } return PARTCFG_BASE_ADDR; }
	else if (strcmp(dbg_str, "PARTCFG") == 0) { if (write) { PARTCFG = value; } return PARTCFG; }
	else if (strcmp(dbg_str, "FIO_BASE_ADDR") == 0) { if (write) { return ERR_INVALID_PARAM; } return FIO_BASE_ADDR; }
	else if (strcmp(dbg_str, "FIO0DIR") == 0) { if (write) { FIO0DIR = value; } return FIO0DIR; }
	else if (strcmp(dbg_str, "FIO0MASK") == 0) { if (write) { FIO0MASK = value; } return FIO0MASK; }
	else if (strcmp(dbg_str, "FIO0PIN") == 0) { if (write) { FIO0PIN = value; } return FIO0PIN; }
	else if (strcmp(dbg_str, "FIO0SET") == 0) { if (write) { FIO0SET = value; } return FIO0SET; }
	else if (strcmp(dbg_str, "FIO0CLR") == 0) { if (write) { FIO0CLR = value; } return FIO0CLR; }
	else if (strcmp(dbg_str, "FIO1DIR") == 0) { if (write) { FIO1DIR = value; } return FIO1DIR; }
	else if (strcmp(dbg_str, "FIO1MASK") == 0) { if (write) { FIO1MASK = value; } return FIO1MASK; }
	else if (strcmp(dbg_str, "FIO1PIN") == 0) { if (write) { FIO1PIN = value; } return FIO1PIN; }
	else if (strcmp(dbg_str, "FIO1SET") == 0) { if (write) { FIO1SET = value; } return FIO1SET; }
	else if (strcmp(dbg_str, "FIO1CLR") == 0) { if (write) { FIO1CLR = value; } return FIO1CLR; }
	else if (strcmp(dbg_str, "FIO2DIR") == 0) { if (write) { FIO2DIR = value; } return FIO2DIR; }
	else if (strcmp(dbg_str, "FIO2MASK") == 0) { if (write) { FIO2MASK = value; } return FIO2MASK; }
	else if (strcmp(dbg_str, "FIO2PIN") == 0) { if (write) { FIO2PIN = value; } return FIO2PIN; }
	else if (strcmp(dbg_str, "FIO2SET") == 0) { if (write) { FIO2SET = value; } return FIO2SET; }
	else if (strcmp(dbg_str, "FIO2CLR") == 0) { if (write) { FIO2CLR = value; } return FIO2CLR; }
	else if (strcmp(dbg_str, "FIO3DIR") == 0) { if (write) { FIO3DIR = value; } return FIO3DIR; }
	else if (strcmp(dbg_str, "FIO3MASK") == 0) { if (write) { FIO3MASK = value; } return FIO3MASK; }
	else if (strcmp(dbg_str, "FIO3PIN") == 0) { if (write) { FIO3PIN = value; } return FIO3PIN; }
	else if (strcmp(dbg_str, "FIO3SET") == 0) { if (write) { FIO3SET = value; } return FIO3SET; }
	else if (strcmp(dbg_str, "FIO3CLR") == 0) { if (write) { FIO3CLR = value; } return FIO3CLR; }
	else if (strcmp(dbg_str, "FIO4DIR") == 0) { if (write) { FIO4DIR = value; } return FIO4DIR; }
	else if (strcmp(dbg_str, "FIO4MASK") == 0) { if (write) { FIO4MASK = value; } return FIO4MASK; }
	else if (strcmp(dbg_str, "FIO4PIN") == 0) { if (write) { FIO4PIN = value; } return FIO4PIN; }
	else if (strcmp(dbg_str, "FIO4SET") == 0) { if (write) { FIO4SET = value; } return FIO4SET; }
	else if (strcmp(dbg_str, "FIO4CLR") == 0) { if (write) { FIO4CLR = value; } return FIO4CLR; }
	else if (strcmp(dbg_str, "FIO0DIR0") == 0) { if (write) { FIO0DIR0 = value; } return FIO0DIR0; }
	else if (strcmp(dbg_str, "FIO1DIR0") == 0) { if (write) { FIO1DIR0 = value; } return FIO1DIR0; }
	else if (strcmp(dbg_str, "FIO2DIR0") == 0) { if (write) { FIO2DIR0 = value; } return FIO2DIR0; }
	else if (strcmp(dbg_str, "FIO3DIR0") == 0) { if (write) { FIO3DIR0 = value; } return FIO3DIR0; }
	else if (strcmp(dbg_str, "FIO4DIR0") == 0) { if (write) { FIO4DIR0 = value; } return FIO4DIR0; }
	else if (strcmp(dbg_str, "FIO0DIR1") == 0) { if (write) { FIO0DIR1 = value; } return FIO0DIR1; }
	else if (strcmp(dbg_str, "FIO1DIR1") == 0) { if (write) { FIO1DIR1 = value; } return FIO1DIR1; }
	else if (strcmp(dbg_str, "FIO2DIR1") == 0) { if (write) { FIO2DIR1 = value; } return FIO2DIR1; }
	else if (strcmp(dbg_str, "FIO3DIR1") == 0) { if (write) { FIO3DIR1 = value; } return FIO3DIR1; }
	else if (strcmp(dbg_str, "FIO4DIR1") == 0) { if (write) { FIO4DIR1 = value; } return FIO4DIR1; }
	else if (strcmp(dbg_str, "FIO0DIR2") == 0) { if (write) { FIO0DIR2 = value; } return FIO0DIR2; }
	else if (strcmp(dbg_str, "FIO1DIR2") == 0) { if (write) { FIO1DIR2 = value; } return FIO1DIR2; }
	else if (strcmp(dbg_str, "FIO2DIR2") == 0) { if (write) { FIO2DIR2 = value; } return FIO2DIR2; }
	else if (strcmp(dbg_str, "FIO3DIR2") == 0) { if (write) { FIO3DIR2 = value; } return FIO3DIR2; }
	else if (strcmp(dbg_str, "FIO4DIR2") == 0) { if (write) { FIO4DIR2 = value; } return FIO4DIR2; }
	else if (strcmp(dbg_str, "FIO0DIR3") == 0) { if (write) { FIO0DIR3 = value; } return FIO0DIR3; }
	else if (strcmp(dbg_str, "FIO1DIR3") == 0) { if (write) { FIO1DIR3 = value; } return FIO1DIR3; }
	else if (strcmp(dbg_str, "FIO2DIR3") == 0) { if (write) { FIO2DIR3 = value; } return FIO2DIR3; }
	else if (strcmp(dbg_str, "FIO3DIR3") == 0) { if (write) { FIO3DIR3 = value; } return FIO3DIR3; }
	else if (strcmp(dbg_str, "FIO4DIR3") == 0) { if (write) { FIO4DIR3 = value; } return FIO4DIR3; }
	else if (strcmp(dbg_str, "FIO0DIRL") == 0) { if (write) { FIO0DIRL = value; } return FIO0DIRL; }
	else if (strcmp(dbg_str, "FIO1DIRL") == 0) { if (write) { FIO1DIRL = value; } return FIO1DIRL; }
	else if (strcmp(dbg_str, "FIO2DIRL") == 0) { if (write) { FIO2DIRL = value; } return FIO2DIRL; }
	else if (strcmp(dbg_str, "FIO3DIRL") == 0) { if (write) { FIO3DIRL = value; } return FIO3DIRL; }
	else if (strcmp(dbg_str, "FIO4DIRL") == 0) { if (write) { FIO4DIRL = value; } return FIO4DIRL; }
	else if (strcmp(dbg_str, "FIO0DIRU") == 0) { if (write) { FIO0DIRU = value; } return FIO0DIRU; }
	else if (strcmp(dbg_str, "FIO1DIRU") == 0) { if (write) { FIO1DIRU = value; } return FIO1DIRU; }
	else if (strcmp(dbg_str, "FIO2DIRU") == 0) { if (write) { FIO2DIRU = value; } return FIO2DIRU; }
	else if (strcmp(dbg_str, "FIO3DIRU") == 0) { if (write) { FIO3DIRU = value; } return FIO3DIRU; }
	else if (strcmp(dbg_str, "FIO4DIRU") == 0) { if (write) { FIO4DIRU = value; } return FIO4DIRU; }
	else if (strcmp(dbg_str, "FIO0MASK0") == 0) { if (write) { FIO0MASK0 = value; } return FIO0MASK0; }
	else if (strcmp(dbg_str, "FIO1MASK0") == 0) { if (write) { FIO1MASK0 = value; } return FIO1MASK0; }
	else if (strcmp(dbg_str, "FIO2MASK0") == 0) { if (write) { FIO2MASK0 = value; } return FIO2MASK0; }
	else if (strcmp(dbg_str, "FIO3MASK0") == 0) { if (write) { FIO3MASK0 = value; } return FIO3MASK0; }
	else if (strcmp(dbg_str, "FIO4MASK0") == 0) { if (write) { FIO4MASK0 = value; } return FIO4MASK0; }
	else if (strcmp(dbg_str, "FIO0MASK1") == 0) { if (write) { FIO0MASK1 = value; } return FIO0MASK1; }
	else if (strcmp(dbg_str, "FIO1MASK1") == 0) { if (write) { FIO1MASK1 = value; } return FIO1MASK1; }
	else if (strcmp(dbg_str, "FIO2MASK1") == 0) { if (write) { FIO2MASK1 = value; } return FIO2MASK1; }
	else if (strcmp(dbg_str, "FIO3MASK1") == 0) { if (write) { FIO3MASK1 = value; } return FIO3MASK1; }
	else if (strcmp(dbg_str, "FIO4MASK1") == 0) { if (write) { FIO4MASK1 = value; } return FIO4MASK1; }
	else if (strcmp(dbg_str, "FIO0MASK2") == 0) { if (write) { FIO0MASK2 = value; } return FIO0MASK2; }
	else if (strcmp(dbg_str, "FIO1MASK2") == 0) { if (write) { FIO1MASK2 = value; } return FIO1MASK2; }
	else if (strcmp(dbg_str, "FIO2MASK2") == 0) { if (write) { FIO2MASK2 = value; } return FIO2MASK2; }
	else if (strcmp(dbg_str, "FIO3MASK2") == 0) { if (write) { FIO3MASK2 = value; } return FIO3MASK2; }
	else if (strcmp(dbg_str, "FIO4MASK2") == 0) { if (write) { FIO4MASK2 = value; } return FIO4MASK2; }
	else if (strcmp(dbg_str, "FIO0MASK3") == 0) { if (write) { FIO0MASK3 = value; } return FIO0MASK3; }
	else if (strcmp(dbg_str, "FIO1MASK3") == 0) { if (write) { FIO1MASK3 = value; } return FIO1MASK3; }
	else if (strcmp(dbg_str, "FIO2MASK3") == 0) { if (write) { FIO2MASK3 = value; } return FIO2MASK3; }
	else if (strcmp(dbg_str, "FIO3MASK3") == 0) { if (write) { FIO3MASK3 = value; } return FIO3MASK3; }
	else if (strcmp(dbg_str, "FIO4MASK3") == 0) { if (write) { FIO4MASK3 = value; } return FIO4MASK3; }
	else if (strcmp(dbg_str, "FIO0MASKL") == 0) { if (write) { FIO0MASKL = value; } return FIO0MASKL; }
	else if (strcmp(dbg_str, "FIO1MASKL") == 0) { if (write) { FIO1MASKL = value; } return FIO1MASKL; }
	else if (strcmp(dbg_str, "FIO2MASKL") == 0) { if (write) { FIO2MASKL = value; } return FIO2MASKL; }
	else if (strcmp(dbg_str, "FIO3MASKL") == 0) { if (write) { FIO3MASKL = value; } return FIO3MASKL; }
	else if (strcmp(dbg_str, "FIO4MASKL") == 0) { if (write) { FIO4MASKL = value; } return FIO4MASKL; }
	else if (strcmp(dbg_str, "FIO0MASKU") == 0) { if (write) { FIO0MASKU = value; } return FIO0MASKU; }
	else if (strcmp(dbg_str, "FIO1MASKU") == 0) { if (write) { FIO1MASKU = value; } return FIO1MASKU; }
	else if (strcmp(dbg_str, "FIO2MASKU") == 0) { if (write) { FIO2MASKU = value; } return FIO2MASKU; }
	else if (strcmp(dbg_str, "FIO3MASKU") == 0) { if (write) { FIO3MASKU = value; } return FIO3MASKU; }
	else if (strcmp(dbg_str, "FIO4MASKU") == 0) { if (write) { FIO4MASKU = value; } return FIO4MASKU; }
	else if (strcmp(dbg_str, "FIO0PIN0") == 0) { if (write) { FIO0PIN0 = value; } return FIO0PIN0; }
	else if (strcmp(dbg_str, "FIO1PIN0") == 0) { if (write) { FIO1PIN0 = value; } return FIO1PIN0; }
	else if (strcmp(dbg_str, "FIO2PIN0") == 0) { if (write) { FIO2PIN0 = value; } return FIO2PIN0; }
	else if (strcmp(dbg_str, "FIO3PIN0") == 0) { if (write) { FIO3PIN0 = value; } return FIO3PIN0; }
	else if (strcmp(dbg_str, "FIO4PIN0") == 0) { if (write) { FIO4PIN0 = value; } return FIO4PIN0; }
	else if (strcmp(dbg_str, "FIO0PIN1") == 0) { if (write) { FIO0PIN1 = value; } return FIO0PIN1; }
	else if (strcmp(dbg_str, "FIO1PIN1") == 0) { if (write) { FIO1PIN1 = value; } return FIO1PIN1; }
	else if (strcmp(dbg_str, "FIO2PIN1") == 0) { if (write) { FIO2PIN1 = value; } return FIO2PIN1; }
	else if (strcmp(dbg_str, "FIO3PIN1") == 0) { if (write) { FIO3PIN1 = value; } return FIO3PIN1; }
	else if (strcmp(dbg_str, "FIO4PIN1") == 0) { if (write) { FIO4PIN1 = value; } return FIO4PIN1; }
	else if (strcmp(dbg_str, "FIO0PIN2") == 0) { if (write) { FIO0PIN2 = value; } return FIO0PIN2; }
	else if (strcmp(dbg_str, "FIO1PIN2") == 0) { if (write) { FIO1PIN2 = value; } return FIO1PIN2; }
	else if (strcmp(dbg_str, "FIO2PIN2") == 0) { if (write) { FIO2PIN2 = value; } return FIO2PIN2; }
	else if (strcmp(dbg_str, "FIO3PIN2") == 0) { if (write) { FIO3PIN2 = value; } return FIO3PIN2; }
	else if (strcmp(dbg_str, "FIO4PIN2") == 0) { if (write) { FIO4PIN2 = value; } return FIO4PIN2; }
	else if (strcmp(dbg_str, "FIO0PIN3") == 0) { if (write) { FIO0PIN3 = value; } return FIO0PIN3; }
	else if (strcmp(dbg_str, "FIO1PIN3") == 0) { if (write) { FIO1PIN3 = value; } return FIO1PIN3; }
	else if (strcmp(dbg_str, "FIO2PIN3") == 0) { if (write) { FIO2PIN3 = value; } return FIO2PIN3; }
	else if (strcmp(dbg_str, "FIO3PIN3") == 0) { if (write) { FIO3PIN3 = value; } return FIO3PIN3; }
	else if (strcmp(dbg_str, "FIO4PIN3") == 0) { if (write) { FIO4PIN3 = value; } return FIO4PIN3; }
	else if (strcmp(dbg_str, "FIO0PINL") == 0) { if (write) { FIO0PINL = value; } return FIO0PINL; }
	else if (strcmp(dbg_str, "FIO1PINL") == 0) { if (write) { FIO1PINL = value; } return FIO1PINL; }
	else if (strcmp(dbg_str, "FIO2PINL") == 0) { if (write) { FIO2PINL = value; } return FIO2PINL; }
	else if (strcmp(dbg_str, "FIO3PINL") == 0) { if (write) { FIO3PINL = value; } return FIO3PINL; }
	else if (strcmp(dbg_str, "FIO4PINL") == 0) { if (write) { FIO4PINL = value; } return FIO4PINL; }
	else if (strcmp(dbg_str, "FIO0PINU") == 0) { if (write) { FIO0PINU = value; } return FIO0PINU; }
	else if (strcmp(dbg_str, "FIO1PINU") == 0) { if (write) { FIO1PINU = value; } return FIO1PINU; }
	else if (strcmp(dbg_str, "FIO2PINU") == 0) { if (write) { FIO2PINU = value; } return FIO2PINU; }
	else if (strcmp(dbg_str, "FIO3PINU") == 0) { if (write) { FIO3PINU = value; } return FIO3PINU; }
	else if (strcmp(dbg_str, "FIO4PINU") == 0) { if (write) { FIO4PINU = value; } return FIO4PINU; }
	else if (strcmp(dbg_str, "FIO0SET0") == 0) { if (write) { FIO0SET0 = value; } return FIO0SET0; }
	else if (strcmp(dbg_str, "FIO1SET0") == 0) { if (write) { FIO1SET0 = value; } return FIO1SET0; }
	else if (strcmp(dbg_str, "FIO2SET0") == 0) { if (write) { FIO2SET0 = value; } return FIO2SET0; }
	else if (strcmp(dbg_str, "FIO3SET0") == 0) { if (write) { FIO3SET0 = value; } return FIO3SET0; }
	else if (strcmp(dbg_str, "FIO4SET0") == 0) { if (write) { FIO4SET0 = value; } return FIO4SET0; }
	else if (strcmp(dbg_str, "FIO0SET1") == 0) { if (write) { FIO0SET1 = value; } return FIO0SET1; }
	else if (strcmp(dbg_str, "FIO1SET1") == 0) { if (write) { FIO1SET1 = value; } return FIO1SET1; }
	else if (strcmp(dbg_str, "FIO2SET1") == 0) { if (write) { FIO2SET1 = value; } return FIO2SET1; }
	else if (strcmp(dbg_str, "FIO3SET1") == 0) { if (write) { FIO3SET1 = value; } return FIO3SET1; }
	else if (strcmp(dbg_str, "FIO4SET1") == 0) { if (write) { FIO4SET1 = value; } return FIO4SET1; }
	else if (strcmp(dbg_str, "FIO0SET2") == 0) { if (write) { FIO0SET2 = value; } return FIO0SET2; }
	else if (strcmp(dbg_str, "FIO1SET2") == 0) { if (write) { FIO1SET2 = value; } return FIO1SET2; }
	else if (strcmp(dbg_str, "FIO2SET2") == 0) { if (write) { FIO2SET2 = value; } return FIO2SET2; }
	else if (strcmp(dbg_str, "FIO3SET2") == 0) { if (write) { FIO3SET2 = value; } return FIO3SET2; }
	else if (strcmp(dbg_str, "FIO4SET2") == 0) { if (write) { FIO4SET2 = value; } return FIO4SET2; }
	else if (strcmp(dbg_str, "FIO0SET3") == 0) { if (write) { FIO0SET3 = value; } return FIO0SET3; }
	else if (strcmp(dbg_str, "FIO1SET3") == 0) { if (write) { FIO1SET3 = value; } return FIO1SET3; }
	else if (strcmp(dbg_str, "FIO2SET3") == 0) { if (write) { FIO2SET3 = value; } return FIO2SET3; }
	else if (strcmp(dbg_str, "FIO3SET3") == 0) { if (write) { FIO3SET3 = value; } return FIO3SET3; }
	else if (strcmp(dbg_str, "FIO4SET3") == 0) { if (write) { FIO4SET3 = value; } return FIO4SET3; }
	else if (strcmp(dbg_str, "FIO0SETL") == 0) { if (write) { FIO0SETL = value; } return FIO0SETL; }
	else if (strcmp(dbg_str, "FIO1SETL") == 0) { if (write) { FIO1SETL = value; } return FIO1SETL; }
	else if (strcmp(dbg_str, "FIO2SETL") == 0) { if (write) { FIO2SETL = value; } return FIO2SETL; }
	else if (strcmp(dbg_str, "FIO3SETL") == 0) { if (write) { FIO3SETL = value; } return FIO3SETL; }
	else if (strcmp(dbg_str, "FIO4SETL") == 0) { if (write) { FIO4SETL = value; } return FIO4SETL; }
	else if (strcmp(dbg_str, "FIO0SETU") == 0) { if (write) { FIO0SETU = value; } return FIO0SETU; }
	else if (strcmp(dbg_str, "FIO1SETU") == 0) { if (write) { FIO1SETU = value; } return FIO1SETU; }
	else if (strcmp(dbg_str, "FIO2SETU") == 0) { if (write) { FIO2SETU = value; } return FIO2SETU; }
	else if (strcmp(dbg_str, "FIO3SETU") == 0) { if (write) { FIO3SETU = value; } return FIO3SETU; }
	else if (strcmp(dbg_str, "FIO4SETU") == 0) { if (write) { FIO4SETU = value; } return FIO4SETU; }
	else if (strcmp(dbg_str, "FIO0CLR0") == 0) { if (write) { FIO0CLR0 = value; } return FIO0CLR0; }
	else if (strcmp(dbg_str, "FIO1CLR0") == 0) { if (write) { FIO1CLR0 = value; } return FIO1CLR0; }
	else if (strcmp(dbg_str, "FIO2CLR0") == 0) { if (write) { FIO2CLR0 = value; } return FIO2CLR0; }
	else if (strcmp(dbg_str, "FIO3CLR0") == 0) { if (write) { FIO3CLR0 = value; } return FIO3CLR0; }
	else if (strcmp(dbg_str, "FIO4CLR0") == 0) { if (write) { FIO4CLR0 = value; } return FIO4CLR0; }
	else if (strcmp(dbg_str, "FIO0CLR1") == 0) { if (write) { FIO0CLR1 = value; } return FIO0CLR1; }
	else if (strcmp(dbg_str, "FIO1CLR1") == 0) { if (write) { FIO1CLR1 = value; } return FIO1CLR1; }
	else if (strcmp(dbg_str, "FIO2CLR1") == 0) { if (write) { FIO2CLR1 = value; } return FIO2CLR1; }
	else if (strcmp(dbg_str, "FIO3CLR1") == 0) { if (write) { FIO3CLR1 = value; } return FIO3CLR1; }
	else if (strcmp(dbg_str, "FIO4CLR1") == 0) { if (write) { FIO4CLR1 = value; } return FIO4CLR1; }
	else if (strcmp(dbg_str, "FIO0CLR2") == 0) { if (write) { FIO0CLR2 = value; } return FIO0CLR2; }
	else if (strcmp(dbg_str, "FIO1CLR2") == 0) { if (write) { FIO1CLR2 = value; } return FIO1CLR2; }
	else if (strcmp(dbg_str, "FIO2CLR2") == 0) { if (write) { FIO2CLR2 = value; } return FIO2CLR2; }
	else if (strcmp(dbg_str, "FIO3CLR2") == 0) { if (write) { FIO3CLR2 = value; } return FIO3CLR2; }
	else if (strcmp(dbg_str, "FIO4CLR2") == 0) { if (write) { FIO4CLR2 = value; } return FIO4CLR2; }
	else if (strcmp(dbg_str, "FIO0CLR3") == 0) { if (write) { FIO0CLR3 = value; } return FIO0CLR3; }
	else if (strcmp(dbg_str, "FIO1CLR3") == 0) { if (write) { FIO1CLR3 = value; } return FIO1CLR3; }
	else if (strcmp(dbg_str, "FIO2CLR3") == 0) { if (write) { FIO2CLR3 = value; } return FIO2CLR3; }
	else if (strcmp(dbg_str, "FIO3CLR3") == 0) { if (write) { FIO3CLR3 = value; } return FIO3CLR3; }
	else if (strcmp(dbg_str, "FIO4CLR3") == 0) { if (write) { FIO4CLR3 = value; } return FIO4CLR3; }
	else if (strcmp(dbg_str, "FIO0CLRL") == 0) { if (write) { FIO0CLRL = value; } return FIO0CLRL; }
	else if (strcmp(dbg_str, "FIO1CLRL") == 0) { if (write) { FIO1CLRL = value; } return FIO1CLRL; }
	else if (strcmp(dbg_str, "FIO2CLRL") == 0) { if (write) { FIO2CLRL = value; } return FIO2CLRL; }
	else if (strcmp(dbg_str, "FIO3CLRL") == 0) { if (write) { FIO3CLRL = value; } return FIO3CLRL; }
	else if (strcmp(dbg_str, "FIO4CLRL") == 0) { if (write) { FIO4CLRL = value; } return FIO4CLRL; }
	else if (strcmp(dbg_str, "FIO0CLRU") == 0) { if (write) { FIO0CLRU = value; } return FIO0CLRU; }
	else if (strcmp(dbg_str, "FIO1CLRU") == 0) { if (write) { FIO1CLRU = value; } return FIO1CLRU; }
	else if (strcmp(dbg_str, "FIO2CLRU") == 0) { if (write) { FIO2CLRU = value; } return FIO2CLRU; }
	else if (strcmp(dbg_str, "FIO3CLRU") == 0) { if (write) { FIO3CLRU = value; } return FIO3CLRU; }
	else if (strcmp(dbg_str, "FIO4CLRU") == 0) { if (write) { FIO4CLRU = value; } return FIO4CLRU; }
	else if (strcmp(dbg_str, "SCB_BASE_ADDR") == 0) { if (write) { return ERR_INVALID_PARAM; } return SCB_BASE_ADDR; }
	else if (strcmp(dbg_str, "MAMCR") == 0) { if (write) { MAMCR = value; } return MAMCR; }
	else if (strcmp(dbg_str, "MAMTIM") == 0) { if (write) { MAMTIM = value; } return MAMTIM; }
	else if (strcmp(dbg_str, "MEMMAP") == 0) { if (write) { MEMMAP = value; } return MEMMAP; }
	else if (strcmp(dbg_str, "PLLCON") == 0) { if (write) { PLLCON = value; } return PLLCON; }
	else if (strcmp(dbg_str, "PLLCFG") == 0) { if (write) { PLLCFG = value; } return PLLCFG; }
	else if (strcmp(dbg_str, "PLLSTAT") == 0) { if (write) { PLLSTAT = value; } return PLLSTAT; }
	else if (strcmp(dbg_str, "PLLFEED") == 0) { if (write) { PLLFEED = value; } return PLLFEED; }
	else if (strcmp(dbg_str, "PCON") == 0) { if (write) { PCON = value; } return PCON; }
	else if (strcmp(dbg_str, "PCONP") == 0) { if (write) { PCONP = value; } return PCONP; }
	else if (strcmp(dbg_str, "APBDIV") == 0) { if (write) { APBDIV = value; } return APBDIV; }
	else if (strcmp(dbg_str, "CCLKCFG") == 0) { if (write) { CCLKCFG = value; } return CCLKCFG; }
	else if (strcmp(dbg_str, "USBCLKCFG") == 0) { if (write) { USBCLKCFG = value; } return USBCLKCFG; }
	else if (strcmp(dbg_str, "CLKSRCSEL") == 0) { if (write) { CLKSRCSEL = value; } return CLKSRCSEL; }
	else if (strcmp(dbg_str, "PCLKSEL0") == 0) { if (write) { PCLKSEL0 = value; } return PCLKSEL0; }
	else if (strcmp(dbg_str, "PCLKSEL1") == 0) { if (write) { PCLKSEL1 = value; } return PCLKSEL1; }
	else if (strcmp(dbg_str, "EXTINT") == 0) { if (write) { EXTINT = value; } return EXTINT; }
	else if (strcmp(dbg_str, "INTWAKE") == 0) { if (write) { INTWAKE = value; } return INTWAKE; }
	else if (strcmp(dbg_str, "EXTMODE") == 0) { if (write) { EXTMODE = value; } return EXTMODE; }
	else if (strcmp(dbg_str, "EXTPOLAR") == 0) { if (write) { EXTPOLAR = value; } return EXTPOLAR; }
	else if (strcmp(dbg_str, "RSIR") == 0) { if (write) { RSIR = value; } return RSIR; }
	else if (strcmp(dbg_str, "CSPR") == 0) { if (write) { CSPR = value; } return CSPR; }
	else if (strcmp(dbg_str, "AHBCFG1") == 0) { if (write) { AHBCFG1 = value; } return AHBCFG1; }
	else if (strcmp(dbg_str, "AHBCFG2") == 0) { if (write) { AHBCFG2 = value; } return AHBCFG2; }
	else if (strcmp(dbg_str, "SCS") == 0) { if (write) { SCS = value; } return SCS; }
	else if (strcmp(dbg_str, "STATIC_MEM0_BASE") == 0) { if (write) { return ERR_INVALID_PARAM; } return STATIC_MEM0_BASE; }
	else if (strcmp(dbg_str, "STATIC_MEM1_BASE") == 0) { if (write) { return ERR_INVALID_PARAM; } return STATIC_MEM1_BASE; }
	else if (strcmp(dbg_str, "STATIC_MEM2_BASE") == 0) { if (write) { return ERR_INVALID_PARAM; } return STATIC_MEM2_BASE; }
	else if (strcmp(dbg_str, "STATIC_MEM3_BASE") == 0) { if (write) { return ERR_INVALID_PARAM; } return STATIC_MEM3_BASE; }
	else if (strcmp(dbg_str, "DYNAMIC_MEM0_BASE") == 0) { if (write) { return ERR_INVALID_PARAM; } return DYNAMIC_MEM0_BASE; }
	else if (strcmp(dbg_str, "DYNAMIC_MEM1_BASE") == 0) { if (write) { return ERR_INVALID_PARAM; } return DYNAMIC_MEM1_BASE; }
	else if (strcmp(dbg_str, "DYNAMIC_MEM2_BASE") == 0) { if (write) { return ERR_INVALID_PARAM; } return DYNAMIC_MEM2_BASE; }
	else if (strcmp(dbg_str, "DYNAMIC_MEM3_BASE") == 0) { if (write) { return ERR_INVALID_PARAM; } return DYNAMIC_MEM3_BASE; }
	else if (strcmp(dbg_str, "EMC_BASE_ADDR") == 0) { if (write) { return ERR_INVALID_PARAM; } return EMC_BASE_ADDR; }
	else if (strcmp(dbg_str, "EMC_CTRL") == 0) { if (write) { EMC_CTRL = value; } return EMC_CTRL; }
	else if (strcmp(dbg_str, "EMC_STAT") == 0) { if (write) { EMC_STAT = value; } return EMC_STAT; }
	else if (strcmp(dbg_str, "EMC_CONFIG") == 0) { if (write) { EMC_CONFIG = value; } return EMC_CONFIG; }
	else if (strcmp(dbg_str, "EMC_DYN_CTRL") == 0) { if (write) { EMC_DYN_CTRL = value; } return EMC_DYN_CTRL; }
	else if (strcmp(dbg_str, "EMC_DYN_RFSH") == 0) { if (write) { EMC_DYN_RFSH = value; } return EMC_DYN_RFSH; }
	else if (strcmp(dbg_str, "EMC_DYN_RD_CFG") == 0) { if (write) { EMC_DYN_RD_CFG = value; } return EMC_DYN_RD_CFG; }
	else if (strcmp(dbg_str, "EMC_DYN_RP") == 0) { if (write) { EMC_DYN_RP = value; } return EMC_DYN_RP; }
	else if (strcmp(dbg_str, "EMC_DYN_RAS") == 0) { if (write) { EMC_DYN_RAS = value; } return EMC_DYN_RAS; }
	else if (strcmp(dbg_str, "EMC_DYN_SREX") == 0) { if (write) { EMC_DYN_SREX = value; } return EMC_DYN_SREX; }
	else if (strcmp(dbg_str, "EMC_DYN_APR") == 0) { if (write) { EMC_DYN_APR = value; } return EMC_DYN_APR; }
	else if (strcmp(dbg_str, "EMC_DYN_DAL") == 0) { if (write) { EMC_DYN_DAL = value; } return EMC_DYN_DAL; }
	else if (strcmp(dbg_str, "EMC_DYN_WR") == 0) { if (write) { EMC_DYN_WR = value; } return EMC_DYN_WR; }
	else if (strcmp(dbg_str, "EMC_DYN_RC") == 0) { if (write) { EMC_DYN_RC = value; } return EMC_DYN_RC; }
	else if (strcmp(dbg_str, "EMC_DYN_RFC") == 0) { if (write) { EMC_DYN_RFC = value; } return EMC_DYN_RFC; }
	else if (strcmp(dbg_str, "EMC_DYN_XSR") == 0) { if (write) { EMC_DYN_XSR = value; } return EMC_DYN_XSR; }
	else if (strcmp(dbg_str, "EMC_DYN_RRD") == 0) { if (write) { EMC_DYN_RRD = value; } return EMC_DYN_RRD; }
	else if (strcmp(dbg_str, "EMC_DYN_MRD") == 0) { if (write) { EMC_DYN_MRD = value; } return EMC_DYN_MRD; }
	else if (strcmp(dbg_str, "EMC_DYN_CFG0") == 0) { if (write) { EMC_DYN_CFG0 = value; } return EMC_DYN_CFG0; }
	else if (strcmp(dbg_str, "EMC_DYN_RASCAS0") == 0) { if (write) { EMC_DYN_RASCAS0 = value; } return EMC_DYN_RASCAS0; }
	else if (strcmp(dbg_str, "EMC_DYN_CFG1") == 0) { if (write) { EMC_DYN_CFG1 = value; } return EMC_DYN_CFG1; }
	else if (strcmp(dbg_str, "EMC_DYN_RASCAS1") == 0) { if (write) { EMC_DYN_RASCAS1 = value; } return EMC_DYN_RASCAS1; }
	else if (strcmp(dbg_str, "EMC_DYN_CFG2") == 0) { if (write) { EMC_DYN_CFG2 = value; } return EMC_DYN_CFG2; }
	else if (strcmp(dbg_str, "EMC_DYN_RASCAS2") == 0) { if (write) { EMC_DYN_RASCAS2 = value; } return EMC_DYN_RASCAS2; }
	else if (strcmp(dbg_str, "EMC_DYN_CFG3") == 0) { if (write) { EMC_DYN_CFG3 = value; } return EMC_DYN_CFG3; }
	else if (strcmp(dbg_str, "EMC_DYN_RASCAS3") == 0) { if (write) { EMC_DYN_RASCAS3 = value; } return EMC_DYN_RASCAS3; }
	else if (strcmp(dbg_str, "EMC_STA_CFG0") == 0) { if (write) { EMC_STA_CFG0 = value; } return EMC_STA_CFG0; }
	else if (strcmp(dbg_str, "EMC_STA_WAITWEN0") == 0) { if (write) { EMC_STA_WAITWEN0 = value; } return EMC_STA_WAITWEN0; }
	else if (strcmp(dbg_str, "EMC_STA_WAITOEN0") == 0) { if (write) { EMC_STA_WAITOEN0 = value; } return EMC_STA_WAITOEN0; }
	else if (strcmp(dbg_str, "EMC_STA_WAITRD0") == 0) { if (write) { EMC_STA_WAITRD0 = value; } return EMC_STA_WAITRD0; }
	else if (strcmp(dbg_str, "EMC_STA_WAITPAGE0") == 0) { if (write) { EMC_STA_WAITPAGE0 = value; } return EMC_STA_WAITPAGE0; }
	else if (strcmp(dbg_str, "EMC_STA_WAITWR0") == 0) { if (write) { EMC_STA_WAITWR0 = value; } return EMC_STA_WAITWR0; }
	else if (strcmp(dbg_str, "EMC_STA_WAITTURN0") == 0) { if (write) { EMC_STA_WAITTURN0 = value; } return EMC_STA_WAITTURN0; }
	else if (strcmp(dbg_str, "EMC_STA_CFG1") == 0) { if (write) { EMC_STA_CFG1 = value; } return EMC_STA_CFG1; }
	else if (strcmp(dbg_str, "EMC_STA_WAITWEN1") == 0) { if (write) { EMC_STA_WAITWEN1 = value; } return EMC_STA_WAITWEN1; }
	else if (strcmp(dbg_str, "EMC_STA_WAITOEN1") == 0) { if (write) { EMC_STA_WAITOEN1 = value; } return EMC_STA_WAITOEN1; }
	else if (strcmp(dbg_str, "EMC_STA_WAITRD1") == 0) { if (write) { EMC_STA_WAITRD1 = value; } return EMC_STA_WAITRD1; }
	else if (strcmp(dbg_str, "EMC_STA_WAITPAGE1") == 0) { if (write) { EMC_STA_WAITPAGE1 = value; } return EMC_STA_WAITPAGE1; }
	else if (strcmp(dbg_str, "EMC_STA_WAITWR1") == 0) { if (write) { EMC_STA_WAITWR1 = value; } return EMC_STA_WAITWR1; }
	else if (strcmp(dbg_str, "EMC_STA_WAITTURN1") == 0) { if (write) { EMC_STA_WAITTURN1 = value; } return EMC_STA_WAITTURN1; }
	else if (strcmp(dbg_str, "EMC_STA_CFG2") == 0) { if (write) { EMC_STA_CFG2 = value; } return EMC_STA_CFG2; }
	else if (strcmp(dbg_str, "EMC_STA_WAITWEN2") == 0) { if (write) { EMC_STA_WAITWEN2 = value; } return EMC_STA_WAITWEN2; }
	else if (strcmp(dbg_str, "EMC_STA_WAITOEN2") == 0) { if (write) { EMC_STA_WAITOEN2 = value; } return EMC_STA_WAITOEN2; }
	else if (strcmp(dbg_str, "EMC_STA_WAITRD2") == 0) { if (write) { EMC_STA_WAITRD2 = value; } return EMC_STA_WAITRD2; }
	else if (strcmp(dbg_str, "EMC_STA_WAITPAGE2") == 0) { if (write) { EMC_STA_WAITPAGE2 = value; } return EMC_STA_WAITPAGE2; }
	else if (strcmp(dbg_str, "EMC_STA_WAITWR2") == 0) { if (write) { EMC_STA_WAITWR2 = value; } return EMC_STA_WAITWR2; }
	else if (strcmp(dbg_str, "EMC_STA_WAITTURN2") == 0) { if (write) { EMC_STA_WAITTURN2 = value; } return EMC_STA_WAITTURN2; }
	else if (strcmp(dbg_str, "EMC_STA_CFG3") == 0) { if (write) { EMC_STA_CFG3 = value; } return EMC_STA_CFG3; }
	else if (strcmp(dbg_str, "EMC_STA_WAITWEN3") == 0) { if (write) { EMC_STA_WAITWEN3 = value; } return EMC_STA_WAITWEN3; }
	else if (strcmp(dbg_str, "EMC_STA_WAITOEN3") == 0) { if (write) { EMC_STA_WAITOEN3 = value; } return EMC_STA_WAITOEN3; }
	else if (strcmp(dbg_str, "EMC_STA_WAITRD3") == 0) { if (write) { EMC_STA_WAITRD3 = value; } return EMC_STA_WAITRD3; }
	else if (strcmp(dbg_str, "EMC_STA_WAITPAGE3") == 0) { if (write) { EMC_STA_WAITPAGE3 = value; } return EMC_STA_WAITPAGE3; }
	else if (strcmp(dbg_str, "EMC_STA_WAITWR3") == 0) { if (write) { EMC_STA_WAITWR3 = value; } return EMC_STA_WAITWR3; }
	else if (strcmp(dbg_str, "EMC_STA_WAITTURN3") == 0) { if (write) { EMC_STA_WAITTURN3 = value; } return EMC_STA_WAITTURN3; }
	else if (strcmp(dbg_str, "EMC_STA_EXT_WAIT") == 0) { if (write) { EMC_STA_EXT_WAIT = value; } return EMC_STA_EXT_WAIT; }
	else if (strcmp(dbg_str, "TMR0_BASE_ADDR") == 0) { if (write) { return ERR_INVALID_PARAM; } return TMR0_BASE_ADDR; }
	else if (strcmp(dbg_str, "T0IR") == 0) { if (write) { T0IR = value; } return T0IR; }
	else if (strcmp(dbg_str, "T0TCR") == 0) { if (write) { T0TCR = value; } return T0TCR; }
	else if (strcmp(dbg_str, "T0TC") == 0) { if (write) { T0TC = value; } return T0TC; }
	else if (strcmp(dbg_str, "T0PR") == 0) { if (write) { T0PR = value; } return T0PR; }
	else if (strcmp(dbg_str, "T0PC") == 0) { if (write) { T0PC = value; } return T0PC; }
	else if (strcmp(dbg_str, "T0MCR") == 0) { if (write) { T0MCR = value; } return T0MCR; }
	else if (strcmp(dbg_str, "T0MR0") == 0) { if (write) { T0MR0 = value; } return T0MR0; }
	else if (strcmp(dbg_str, "T0MR1") == 0) { if (write) { T0MR1 = value; } return T0MR1; }
	else if (strcmp(dbg_str, "T0MR2") == 0) { if (write) { T0MR2 = value; } return T0MR2; }
	else if (strcmp(dbg_str, "T0MR3") == 0) { if (write) { T0MR3 = value; } return T0MR3; }
	else if (strcmp(dbg_str, "T0CCR") == 0) { if (write) { T0CCR = value; } return T0CCR; }
	else if (strcmp(dbg_str, "T0CR0") == 0) { if (write) { T0CR0 = value; } return T0CR0; }
	else if (strcmp(dbg_str, "T0CR1") == 0) { if (write) { T0CR1 = value; } return T0CR1; }
	else if (strcmp(dbg_str, "T0CR2") == 0) { if (write) { T0CR2 = value; } return T0CR2; }
	else if (strcmp(dbg_str, "T0CR3") == 0) { if (write) { T0CR3 = value; } return T0CR3; }
	else if (strcmp(dbg_str, "T0EMR") == 0) { if (write) { T0EMR = value; } return T0EMR; }
	else if (strcmp(dbg_str, "T0CTCR") == 0) { if (write) { T0CTCR = value; } return T0CTCR; }
	else if (strcmp(dbg_str, "TMR1_BASE_ADDR") == 0) { if (write) { return ERR_INVALID_PARAM; } return TMR1_BASE_ADDR; }
	else if (strcmp(dbg_str, "T1IR") == 0) { if (write) { T1IR = value; } return T1IR; }
	else if (strcmp(dbg_str, "T1TCR") == 0) { if (write) { T1TCR = value; } return T1TCR; }
	else if (strcmp(dbg_str, "T1TC") == 0) { if (write) { T1TC = value; } return T1TC; }
	else if (strcmp(dbg_str, "T1PR") == 0) { if (write) { T1PR = value; } return T1PR; }
	else if (strcmp(dbg_str, "T1PC") == 0) { if (write) { T1PC = value; } return T1PC; }
	else if (strcmp(dbg_str, "T1MCR") == 0) { if (write) { T1MCR = value; } return T1MCR; }
	else if (strcmp(dbg_str, "T1MR0") == 0) { if (write) { T1MR0 = value; } return T1MR0; }
	else if (strcmp(dbg_str, "T1MR1") == 0) { if (write) { T1MR1 = value; } return T1MR1; }
	else if (strcmp(dbg_str, "T1MR2") == 0) { if (write) { T1MR2 = value; } return T1MR2; }
	else if (strcmp(dbg_str, "T1MR3") == 0) { if (write) { T1MR3 = value; } return T1MR3; }
	else if (strcmp(dbg_str, "T1CCR") == 0) { if (write) { T1CCR = value; } return T1CCR; }
	else if (strcmp(dbg_str, "T1CR0") == 0) { if (write) { T1CR0 = value; } return T1CR0; }
	else if (strcmp(dbg_str, "T1CR1") == 0) { if (write) { T1CR1 = value; } return T1CR1; }
	else if (strcmp(dbg_str, "T1CR2") == 0) { if (write) { T1CR2 = value; } return T1CR2; }
	else if (strcmp(dbg_str, "T1CR3") == 0) { if (write) { T1CR3 = value; } return T1CR3; }
	else if (strcmp(dbg_str, "T1EMR") == 0) { if (write) { T1EMR = value; } return T1EMR; }
	else if (strcmp(dbg_str, "T1CTCR") == 0) { if (write) { T1CTCR = value; } return T1CTCR; }
	else if (strcmp(dbg_str, "TMR2_BASE_ADDR") == 0) { if (write) { return ERR_INVALID_PARAM; } return TMR2_BASE_ADDR; }
	else if (strcmp(dbg_str, "T2IR") == 0) { if (write) { T2IR = value; } return T2IR; }
	else if (strcmp(dbg_str, "T2TCR") == 0) { if (write) { T2TCR = value; } return T2TCR; }
	else if (strcmp(dbg_str, "T2TC") == 0) { if (write) { T2TC = value; } return T2TC; }
	else if (strcmp(dbg_str, "T2PR") == 0) { if (write) { T2PR = value; } return T2PR; }
	else if (strcmp(dbg_str, "T2PC") == 0) { if (write) { T2PC = value; } return T2PC; }
	else if (strcmp(dbg_str, "T2MCR") == 0) { if (write) { T2MCR = value; } return T2MCR; }
	else if (strcmp(dbg_str, "T2MR0") == 0) { if (write) { T2MR0 = value; } return T2MR0; }
	else if (strcmp(dbg_str, "T2MR1") == 0) { if (write) { T2MR1 = value; } return T2MR1; }
	else if (strcmp(dbg_str, "T2MR2") == 0) { if (write) { T2MR2 = value; } return T2MR2; }
	else if (strcmp(dbg_str, "T2MR3") == 0) { if (write) { T2MR3 = value; } return T2MR3; }
	else if (strcmp(dbg_str, "T2CCR") == 0) { if (write) { T2CCR = value; } return T2CCR; }
	else if (strcmp(dbg_str, "T2CR0") == 0) { if (write) { T2CR0 = value; } return T2CR0; }
	else if (strcmp(dbg_str, "T2CR1") == 0) { if (write) { T2CR1 = value; } return T2CR1; }
	else if (strcmp(dbg_str, "T2CR2") == 0) { if (write) { T2CR2 = value; } return T2CR2; }
	else if (strcmp(dbg_str, "T2CR3") == 0) { if (write) { T2CR3 = value; } return T2CR3; }
	else if (strcmp(dbg_str, "T2EMR") == 0) { if (write) { T2EMR = value; } return T2EMR; }
	else if (strcmp(dbg_str, "T2CTCR") == 0) { if (write) { T2CTCR = value; } return T2CTCR; }
	else if (strcmp(dbg_str, "TMR3_BASE_ADDR") == 0) { if (write) { return ERR_INVALID_PARAM; } return TMR3_BASE_ADDR; }
	else if (strcmp(dbg_str, "T3IR") == 0) { if (write) { T3IR = value; } return T3IR; }
	else if (strcmp(dbg_str, "T3TCR") == 0) { if (write) { T3TCR = value; } return T3TCR; }
	else if (strcmp(dbg_str, "T3TC") == 0) { if (write) { T3TC = value; } return T3TC; }
	else if (strcmp(dbg_str, "T3PR") == 0) { if (write) { T3PR = value; } return T3PR; }
	else if (strcmp(dbg_str, "T3PC") == 0) { if (write) { T3PC = value; } return T3PC; }
	else if (strcmp(dbg_str, "T3MCR") == 0) { if (write) { T3MCR = value; } return T3MCR; }
	else if (strcmp(dbg_str, "T3MR0") == 0) { if (write) { T3MR0 = value; } return T3MR0; }
	else if (strcmp(dbg_str, "T3MR1") == 0) { if (write) { T3MR1 = value; } return T3MR1; }
	else if (strcmp(dbg_str, "T3MR2") == 0) { if (write) { T3MR2 = value; } return T3MR2; }
	else if (strcmp(dbg_str, "T3MR3") == 0) { if (write) { T3MR3 = value; } return T3MR3; }
	else if (strcmp(dbg_str, "T3CCR") == 0) { if (write) { T3CCR = value; } return T3CCR; }
	else if (strcmp(dbg_str, "T3CR0") == 0) { if (write) { T3CR0 = value; } return T3CR0; }
	else if (strcmp(dbg_str, "T3CR1") == 0) { if (write) { T3CR1 = value; } return T3CR1; }
	else if (strcmp(dbg_str, "T3CR2") == 0) { if (write) { T3CR2 = value; } return T3CR2; }
	else if (strcmp(dbg_str, "T3CR3") == 0) { if (write) { T3CR3 = value; } return T3CR3; }
	else if (strcmp(dbg_str, "T3EMR") == 0) { if (write) { T3EMR = value; } return T3EMR; }
	else if (strcmp(dbg_str, "T3CTCR") == 0) { if (write) { T3CTCR = value; } return T3CTCR; }
	else if (strcmp(dbg_str, "PWM0_BASE_ADDR") == 0) { if (write) { return ERR_INVALID_PARAM; } return PWM0_BASE_ADDR; }
	else if (strcmp(dbg_str, "PWM0IR") == 0) { if (write) { PWM0IR = value; } return PWM0IR; }
	else if (strcmp(dbg_str, "PWM0TCR") == 0) { if (write) { PWM0TCR = value; } return PWM0TCR; }
	else if (strcmp(dbg_str, "PWM0TC") == 0) { if (write) { PWM0TC = value; } return PWM0TC; }
	else if (strcmp(dbg_str, "PWM0PR") == 0) { if (write) { PWM0PR = value; } return PWM0PR; }
	else if (strcmp(dbg_str, "PWM0PC") == 0) { if (write) { PWM0PC = value; } return PWM0PC; }
	else if (strcmp(dbg_str, "PWM0MCR") == 0) { if (write) { PWM0MCR = value; } return PWM0MCR; }
	else if (strcmp(dbg_str, "PWM0MR0") == 0) { if (write) { PWM0MR0 = value; } return PWM0MR0; }
	else if (strcmp(dbg_str, "PWM0MR1") == 0) { if (write) { PWM0MR1 = value; } return PWM0MR1; }
	else if (strcmp(dbg_str, "PWM0MR2") == 0) { if (write) { PWM0MR2 = value; } return PWM0MR2; }
	else if (strcmp(dbg_str, "PWM0MR3") == 0) { if (write) { PWM0MR3 = value; } return PWM0MR3; }
	else if (strcmp(dbg_str, "PWM0CCR") == 0) { if (write) { PWM0CCR = value; } return PWM0CCR; }
	else if (strcmp(dbg_str, "PWM0CR0") == 0) { if (write) { PWM0CR0 = value; } return PWM0CR0; }
	else if (strcmp(dbg_str, "PWM0CR1") == 0) { if (write) { PWM0CR1 = value; } return PWM0CR1; }
	else if (strcmp(dbg_str, "PWM0CR2") == 0) { if (write) { PWM0CR2 = value; } return PWM0CR2; }
	else if (strcmp(dbg_str, "PWM0CR3") == 0) { if (write) { PWM0CR3 = value; } return PWM0CR3; }
	else if (strcmp(dbg_str, "PWM0EMR") == 0) { if (write) { PWM0EMR = value; } return PWM0EMR; }
	else if (strcmp(dbg_str, "PWM0MR4") == 0) { if (write) { PWM0MR4 = value; } return PWM0MR4; }
	else if (strcmp(dbg_str, "PWM0MR5") == 0) { if (write) { PWM0MR5 = value; } return PWM0MR5; }
	else if (strcmp(dbg_str, "PWM0MR6") == 0) { if (write) { PWM0MR6 = value; } return PWM0MR6; }
	else if (strcmp(dbg_str, "PWM0PCR") == 0) { if (write) { PWM0PCR = value; } return PWM0PCR; }
	else if (strcmp(dbg_str, "PWM0LER") == 0) { if (write) { PWM0LER = value; } return PWM0LER; }
	else if (strcmp(dbg_str, "PWM0CTCR") == 0) { if (write) { PWM0CTCR = value; } return PWM0CTCR; }
	else if (strcmp(dbg_str, "PWM1_BASE_ADDR") == 0) { if (write) { return ERR_INVALID_PARAM; } return PWM1_BASE_ADDR; }
	else if (strcmp(dbg_str, "PWM1IR") == 0) { if (write) { PWM1IR = value; } return PWM1IR; }
	else if (strcmp(dbg_str, "PWM1TCR") == 0) { if (write) { PWM1TCR = value; } return PWM1TCR; }
	else if (strcmp(dbg_str, "PWM1TC") == 0) { if (write) { PWM1TC = value; } return PWM1TC; }
	else if (strcmp(dbg_str, "PWM1PR") == 0) { if (write) { PWM1PR = value; } return PWM1PR; }
	else if (strcmp(dbg_str, "PWM1PC") == 0) { if (write) { PWM1PC = value; } return PWM1PC; }
	else if (strcmp(dbg_str, "PWM1MCR") == 0) { if (write) { PWM1MCR = value; } return PWM1MCR; }
	else if (strcmp(dbg_str, "PWM1MR0") == 0) { if (write) { PWM1MR0 = value; } return PWM1MR0; }
	else if (strcmp(dbg_str, "PWM1MR1") == 0) { if (write) { PWM1MR1 = value; } return PWM1MR1; }
	else if (strcmp(dbg_str, "PWM1MR2") == 0) { if (write) { PWM1MR2 = value; } return PWM1MR2; }
	else if (strcmp(dbg_str, "PWM1MR3") == 0) { if (write) { PWM1MR3 = value; } return PWM1MR3; }
	else if (strcmp(dbg_str, "PWM1CCR") == 0) { if (write) { PWM1CCR = value; } return PWM1CCR; }
	else if (strcmp(dbg_str, "PWM1CR0") == 0) { if (write) { PWM1CR0 = value; } return PWM1CR0; }
	else if (strcmp(dbg_str, "PWM1CR1") == 0) { if (write) { PWM1CR1 = value; } return PWM1CR1; }
	else if (strcmp(dbg_str, "PWM1CR2") == 0) { if (write) { PWM1CR2 = value; } return PWM1CR2; }
	else if (strcmp(dbg_str, "PWM1CR3") == 0) { if (write) { PWM1CR3 = value; } return PWM1CR3; }
	else if (strcmp(dbg_str, "PWM1EMR") == 0) { if (write) { PWM1EMR = value; } return PWM1EMR; }
	else if (strcmp(dbg_str, "PWM1MR4") == 0) { if (write) { PWM1MR4 = value; } return PWM1MR4; }
	else if (strcmp(dbg_str, "PWM1MR5") == 0) { if (write) { PWM1MR5 = value; } return PWM1MR5; }
	else if (strcmp(dbg_str, "PWM1MR6") == 0) { if (write) { PWM1MR6 = value; } return PWM1MR6; }
	else if (strcmp(dbg_str, "PWM1PCR") == 0) { if (write) { PWM1PCR = value; } return PWM1PCR; }
	else if (strcmp(dbg_str, "PWM1LER") == 0) { if (write) { PWM1LER = value; } return PWM1LER; }
	else if (strcmp(dbg_str, "PWM1CTCR") == 0) { if (write) { PWM1CTCR = value; } return PWM1CTCR; }
	else if (strcmp(dbg_str, "UART0_BASE_ADDR") == 0) { if (write) { return ERR_INVALID_PARAM; } return UART0_BASE_ADDR; }
	else if (strcmp(dbg_str, "U0RBR") == 0) { if (write) { U0RBR = value; } return U0RBR; }
	else if (strcmp(dbg_str, "U0THR") == 0) { if (write) { U0THR = value; } return U0THR; }
	else if (strcmp(dbg_str, "U0DLL") == 0) { if (write) { U0DLL = value; } return U0DLL; }
	else if (strcmp(dbg_str, "U0DLM") == 0) { if (write) { U0DLM = value; } return U0DLM; }
	else if (strcmp(dbg_str, "U0IER") == 0) { if (write) { U0IER = value; } return U0IER; }
	else if (strcmp(dbg_str, "U0IIR") == 0) { if (write) { U0IIR = value; } return U0IIR; }
	else if (strcmp(dbg_str, "U0FCR") == 0) return U0FCR;
	else if (strcmp(dbg_str, "U0LCR") == 0) { if (write) { U0LCR = value; } return U0LCR; }
	else if (strcmp(dbg_str, "U0LSR") == 0) { if (write) { U0LSR = value; } return U0LSR; }
	else if (strcmp(dbg_str, "U0SCR") == 0) { if (write) { U0SCR = value; } return U0SCR; }
	else if (strcmp(dbg_str, "U0ACR") == 0) { if (write) { U0ACR = value; } return U0ACR; }
	else if (strcmp(dbg_str, "U0ICR") == 0) { if (write) { U0ICR = value; } return U0ICR; }
	else if (strcmp(dbg_str, "U0FDR") == 0) { if (write) { U0FDR = value; } return U0FDR; }
	else if (strcmp(dbg_str, "U0TER") == 0) { if (write) { U0TER = value; } return U0TER; }
	else if (strcmp(dbg_str, "UART1_BASE_ADDR") == 0) { if (write) { return ERR_INVALID_PARAM; } return UART1_BASE_ADDR; }
	else if (strcmp(dbg_str, "U1RBR") == 0) { if (write) { U1RBR = value; } return U1RBR; }
	else if (strcmp(dbg_str, "U1THR") == 0) { if (write) { U1THR = value; } return U1THR; }
	else if (strcmp(dbg_str, "U1DLL") == 0) { if (write) { U1DLL = value; } return U1DLL; }
	else if (strcmp(dbg_str, "U1DLM") == 0) { if (write) { U1DLM = value; } return U1DLM; }
	else if (strcmp(dbg_str, "U1IER") == 0) { if (write) { U1IER = value; } return U1IER; }
	else if (strcmp(dbg_str, "U1IIR") == 0) { if (write) { U1IIR = value; } return U1IIR; }
	else if (strcmp(dbg_str, "U1FCR") == 0) { if (write) { U1FCR = value; } return U1FCR; }
	else if (strcmp(dbg_str, "U1LCR") == 0) { if (write) { U1LCR = value; } return U1LCR; }
	else if (strcmp(dbg_str, "U1MCR") == 0) { if (write) { U1MCR = value; } return U1MCR; }
	else if (strcmp(dbg_str, "U1LSR") == 0) { if (write) { U1LSR = value; } return U1LSR; }
	else if (strcmp(dbg_str, "U1MSR") == 0) { if (write) { U1MSR = value; } return U1MSR; }
	else if (strcmp(dbg_str, "U1SCR") == 0) { if (write) { U1SCR = value; } return U1SCR; }
	else if (strcmp(dbg_str, "U1ACR") == 0) { if (write) { U1ACR = value; } return U1ACR; }
	else if (strcmp(dbg_str, "U1FDR") == 0) { if (write) { U1FDR = value; } return U1FDR; }
	else if (strcmp(dbg_str, "U1TER") == 0) { if (write) { U1TER = value; } return U1TER; }
	else if (strcmp(dbg_str, "UART2_BASE_ADDR") == 0) { if (write) { return ERR_INVALID_PARAM; } return UART2_BASE_ADDR; }
	else if (strcmp(dbg_str, "U2RBR") == 0) { if (write) { U2RBR = value; } return U2RBR; }
	else if (strcmp(dbg_str, "U2THR") == 0) { if (write) { U2THR = value; } return U2THR; }
	else if (strcmp(dbg_str, "U2DLL") == 0) { if (write) { U2DLL = value; } return U2DLL; }
	else if (strcmp(dbg_str, "U2DLM") == 0) { if (write) { U2DLM = value; } return U2DLM; }
	else if (strcmp(dbg_str, "U2IER") == 0) { if (write) { U2IER = value; } return U2IER; }
	else if (strcmp(dbg_str, "U2IIR") == 0) { if (write) { U2IIR = value; } return U2IIR; }
	else if (strcmp(dbg_str, "U2FCR") == 0) { if (write) { U2FCR = value; } return U2FCR; }
	else if (strcmp(dbg_str, "U2LCR") == 0) { if (write) { U2LCR = value; } return U2LCR; }
	else if (strcmp(dbg_str, "U2LSR") == 0) { if (write) { U2LSR = value; } return U2LSR; }
	else if (strcmp(dbg_str, "U2SCR") == 0) { if (write) { U2SCR = value; } return U2SCR; }
	else if (strcmp(dbg_str, "U2ACR") == 0) { if (write) { U2ACR = value; } return U2ACR; }
	else if (strcmp(dbg_str, "U2ICR") == 0) { if (write) { U2ICR = value; } return U2ICR; }
	else if (strcmp(dbg_str, "U2FDR") == 0) { if (write) { U2FDR = value; } return U2FDR; }
	else if (strcmp(dbg_str, "U2TER") == 0) { if (write) { U2TER = value; } return U2TER; }
	else if (strcmp(dbg_str, "UART3_BASE_ADDR") == 0) { if (write) { return ERR_INVALID_PARAM; } return UART3_BASE_ADDR; }
	else if (strcmp(dbg_str, "U3RBR") == 0) { if (write) { U3RBR = value; } return U3RBR; }
	else if (strcmp(dbg_str, "U3THR") == 0) { if (write) { U3THR = value; } return U3THR; }
	else if (strcmp(dbg_str, "U3DLL") == 0) { if (write) { U3DLL = value; } return U3DLL; }
	else if (strcmp(dbg_str, "U3DLM") == 0) { if (write) { U3DLM = value; } return U3DLM; }
	else if (strcmp(dbg_str, "U3IER") == 0) { if (write) { U3IER = value; } return U3IER; }
	else if (strcmp(dbg_str, "U3IIR") == 0) { if (write) { U3IIR = value; } return U3IIR; }
	else if (strcmp(dbg_str, "U3FCR") == 0) { if (write) { U3FCR = value; } return U3FCR; }
	else if (strcmp(dbg_str, "U3LCR") == 0) { if (write) { U3LCR = value; } return U3LCR; }
	else if (strcmp(dbg_str, "U3LSR") == 0) { if (write) { U3LSR = value; } return U3LSR; }
	else if (strcmp(dbg_str, "U3SCR") == 0) { if (write) { U3SCR = value; } return U3SCR; }
	else if (strcmp(dbg_str, "U3ACR") == 0) { if (write) { U3ACR = value; } return U3ACR; }
	else if (strcmp(dbg_str, "U3ICR") == 0) { if (write) { U3ICR = value; } return U3ICR; }
	else if (strcmp(dbg_str, "U3FDR") == 0) { if (write) { U3FDR = value; } return U3FDR; }
	else if (strcmp(dbg_str, "U3TER") == 0) { if (write) { U3TER = value; } return U3TER; }
	else if (strcmp(dbg_str, "I2C0_BASE_ADDR") == 0) { if (write) { return ERR_INVALID_PARAM; } return I2C0_BASE_ADDR; }
	else if (strcmp(dbg_str, "I20CONSET") == 0) { if (write) { I20CONSET = value; } return I20CONSET; }
	else if (strcmp(dbg_str, "I20STAT") == 0) { if (write) { I20STAT = value; } return I20STAT; }
	else if (strcmp(dbg_str, "I20DAT") == 0) { if (write) { I20DAT = value; } return I20DAT; }
	else if (strcmp(dbg_str, "I20ADR") == 0) { if (write) { I20ADR = value; } return I20ADR; }
	else if (strcmp(dbg_str, "I20SCLH") == 0) { if (write) { I20SCLH = value; } return I20SCLH; }
	else if (strcmp(dbg_str, "I20SCLL") == 0) { if (write) { I20SCLL = value; } return I20SCLL; }
	else if (strcmp(dbg_str, "I20CONCLR") == 0) { if (write) { I20CONCLR = value; } return I20CONCLR; }
	else if (strcmp(dbg_str, "I2C0CONSET") == 0) { if (write) { I2C0CONSET = value; } return I2C0CONSET; }
	else if (strcmp(dbg_str, "I2C0STAT") == 0) { if (write) { I2C0STAT = value; } return I2C0STAT; }
	else if (strcmp(dbg_str, "I2C0DAT") == 0) { if (write) { I2C0DAT = value; } return I2C0DAT; }
	else if (strcmp(dbg_str, "I2C0ADR") == 0) { if (write) { I2C0ADR = value; } return I2C0ADR; }
	else if (strcmp(dbg_str, "I2C0SCLH") == 0) { if (write) { I2C0SCLH = value; } return I2C0SCLH; }
	else if (strcmp(dbg_str, "I2C0SCLL") == 0) { if (write) { I2C0SCLL = value; } return I2C0SCLL; }
	else if (strcmp(dbg_str, "I2C0CONCLR") == 0) { if (write) { I2C0CONCLR = value; } return I2C0CONCLR; }
	else if (strcmp(dbg_str, "I2C1_BASE_ADDR") == 0) { if (write) { return ERR_INVALID_PARAM; } return I2C1_BASE_ADDR; }
	else if (strcmp(dbg_str, "I21CONSET") == 0) { if (write) { I21CONSET = value; } return I21CONSET; }
	else if (strcmp(dbg_str, "I21STAT") == 0) { if (write) { I21STAT = value; } return I21STAT; }
	else if (strcmp(dbg_str, "I21DAT") == 0) { if (write) { I21DAT = value; } return I21DAT; }
	else if (strcmp(dbg_str, "I21ADR") == 0) { if (write) { I21ADR = value; } return I21ADR; }
	else if (strcmp(dbg_str, "I21SCLH") == 0) { if (write) { I21SCLH = value; } return I21SCLH; }
	else if (strcmp(dbg_str, "I21SCLL") == 0) { if (write) { I21SCLL = value; } return I21SCLL; }
	else if (strcmp(dbg_str, "I21CONCLR") == 0) { if (write) { I21CONCLR = value; } return I21CONCLR; }
	else if (strcmp(dbg_str, "I2C2_BASE_ADDR") == 0) { if (write) { return ERR_INVALID_PARAM; } return I2C2_BASE_ADDR; }
	else if (strcmp(dbg_str, "I22CONSET") == 0) { if (write) { I22CONSET = value; } return I22CONSET; }
	else if (strcmp(dbg_str, "I22STAT") == 0) { if (write) { I22STAT = value; } return I22STAT; }
	else if (strcmp(dbg_str, "I22DAT") == 0) { if (write) { I22DAT = value; } return I22DAT; }
	else if (strcmp(dbg_str, "I22ADR") == 0) { if (write) { I22ADR = value; } return I22ADR; }
	else if (strcmp(dbg_str, "I22SCLH") == 0) { if (write) { I22SCLH = value; } return I22SCLH; }
	else if (strcmp(dbg_str, "I22SCLL") == 0) { if (write) { I22SCLL = value; } return I22SCLL; }
	else if (strcmp(dbg_str, "I22CONCLR") == 0) { if (write) { I22CONCLR = value; } return I22CONCLR; }
	else if (strcmp(dbg_str, "SPI0_BASE_ADDR") == 0) { if (write) { return ERR_INVALID_PARAM; } return SPI0_BASE_ADDR; }
	else if (strcmp(dbg_str, "S0SPCR") == 0) { if (write) { S0SPCR = value; } return S0SPCR; }
	else if (strcmp(dbg_str, "S0SPSR") == 0) { if (write) { S0SPSR = value; } return S0SPSR; }
	else if (strcmp(dbg_str, "S0SPDR") == 0) { if (write) { S0SPDR = value; } return S0SPDR; }
	else if (strcmp(dbg_str, "S0SPCCR") == 0) { if (write) { S0SPCCR = value; } return S0SPCCR; }
	else if (strcmp(dbg_str, "S0SPINT") == 0) { if (write) { S0SPINT = value; } return S0SPINT; }
	else if (strcmp(dbg_str, "SSP0_BASE_ADDR") == 0) { if (write) { return ERR_INVALID_PARAM; } return SSP0_BASE_ADDR; }
	else if (strcmp(dbg_str, "SSP0CR0") == 0) { if (write) { SSP0CR0 = value; } return SSP0CR0; }
	else if (strcmp(dbg_str, "SSP0CR1") == 0) { if (write) { SSP0CR1 = value; } return SSP0CR1; }
	else if (strcmp(dbg_str, "SSP0DR") == 0) { if (write) { SSP0DR = value; } return SSP0DR; }
	else if (strcmp(dbg_str, "SSP0SR") == 0) { if (write) { SSP0SR = value; } return SSP0SR; }
	else if (strcmp(dbg_str, "SSP0CPSR") == 0) { if (write) { SSP0CPSR = value; } return SSP0CPSR; }
	else if (strcmp(dbg_str, "SSP0IMSC") == 0) { if (write) { SSP0IMSC = value; } return SSP0IMSC; }
	else if (strcmp(dbg_str, "SSP0RIS") == 0) { if (write) { SSP0RIS = value; } return SSP0RIS; }
	else if (strcmp(dbg_str, "SSP0MIS") == 0) { if (write) { SSP0MIS = value; } return SSP0MIS; }
	else if (strcmp(dbg_str, "SSP0ICR") == 0) { if (write) { SSP0ICR = value; } return SSP0ICR; }
	else if (strcmp(dbg_str, "SSP0DMACR") == 0) { if (write) { SSP0DMACR = value; } return SSP0DMACR; }
	else if (strcmp(dbg_str, "SSP1_BASE_ADDR") == 0) { if (write) { return ERR_INVALID_PARAM; } return SSP1_BASE_ADDR; }
	else if (strcmp(dbg_str, "SSP1CR0") == 0) { if (write) { SSP1CR0 = value; } return SSP1CR0; }
	else if (strcmp(dbg_str, "SSP1CR1") == 0) { if (write) { SSP1CR1 = value; } return SSP1CR1; }
	else if (strcmp(dbg_str, "SSP1DR") == 0) { if (write) { SSP1DR = value; } return SSP1DR; }
	else if (strcmp(dbg_str, "SSP1SR") == 0) { if (write) { SSP1SR = value; } return SSP1SR; }
	else if (strcmp(dbg_str, "SSP1CPSR") == 0) { if (write) { SSP1CPSR = value; } return SSP1CPSR; }
	else if (strcmp(dbg_str, "SSP1IMSC") == 0) { if (write) { SSP1IMSC = value; } return SSP1IMSC; }
	else if (strcmp(dbg_str, "SSP1RIS") == 0) { if (write) { SSP1RIS = value; } return SSP1RIS; }
	else if (strcmp(dbg_str, "SSP1MIS") == 0) { if (write) { SSP1MIS = value; } return SSP1MIS; }
	else if (strcmp(dbg_str, "SSP1ICR") == 0) { if (write) { SSP1ICR = value; } return SSP1ICR; }
	else if (strcmp(dbg_str, "SSP1DMACR") == 0) { if (write) { SSP1DMACR = value; } return SSP1DMACR; }
	else if (strcmp(dbg_str, "RTC_BASE_ADDR") == 0) { if (write) { return ERR_INVALID_PARAM; } return RTC_BASE_ADDR; }
	else if (strcmp(dbg_str, "RTC_ILR") == 0) { if (write) { RTC_ILR = value; } return RTC_ILR; }
	else if (strcmp(dbg_str, "RTC_CTC") == 0) { if (write) { RTC_CTC = value; } return RTC_CTC; }
	else if (strcmp(dbg_str, "RTC_CCR") == 0) { if (write) { RTC_CCR = value; } return RTC_CCR; }
	else if (strcmp(dbg_str, "RTC_CIIR") == 0) { if (write) { RTC_CIIR = value; } return RTC_CIIR; }
	else if (strcmp(dbg_str, "RTC_AMR") == 0) { if (write) { RTC_AMR = value; } return RTC_AMR; }
	else if (strcmp(dbg_str, "RTC_CTIME0") == 0) { if (write) { RTC_CTIME0 = value; } return RTC_CTIME0; }
	else if (strcmp(dbg_str, "RTC_CTIME1") == 0) { if (write) { RTC_CTIME1 = value; } return RTC_CTIME1; }
	else if (strcmp(dbg_str, "RTC_CTIME2") == 0) { if (write) { RTC_CTIME2 = value; } return RTC_CTIME2; }
	else if (strcmp(dbg_str, "RTC_SEC") == 0) { if (write) { RTC_SEC = value; } return RTC_SEC; }
	else if (strcmp(dbg_str, "RTC_MIN") == 0) { if (write) { RTC_MIN = value; } return RTC_MIN; }
	else if (strcmp(dbg_str, "RTC_HOUR") == 0) { if (write) { RTC_HOUR = value; } return RTC_HOUR; }
	else if (strcmp(dbg_str, "RTC_DOM") == 0) { if (write) { RTC_DOM = value; } return RTC_DOM; }
	else if (strcmp(dbg_str, "RTC_DOW") == 0) { if (write) { RTC_DOW = value; } return RTC_DOW; }
	else if (strcmp(dbg_str, "RTC_DOY") == 0) { if (write) { RTC_DOY = value; } return RTC_DOY; }
	else if (strcmp(dbg_str, "RTC_MONTH") == 0) { if (write) { RTC_MONTH = value; } return RTC_MONTH; }
	else if (strcmp(dbg_str, "RTC_YEAR") == 0) { if (write) { RTC_YEAR = value; } return RTC_YEAR; }
	else if (strcmp(dbg_str, "RTC_CISS") == 0) { if (write) { RTC_CISS = value; } return RTC_CISS; }
	else if (strcmp(dbg_str, "RTC_ALSEC") == 0) { if (write) { RTC_ALSEC = value; } return RTC_ALSEC; }
	else if (strcmp(dbg_str, "RTC_ALMIN") == 0) { if (write) { RTC_ALMIN = value; } return RTC_ALMIN; }
	else if (strcmp(dbg_str, "RTC_ALHOUR") == 0) { if (write) { RTC_ALHOUR = value; } return RTC_ALHOUR; }
	else if (strcmp(dbg_str, "RTC_ALDOM") == 0) { if (write) { RTC_ALDOM = value; } return RTC_ALDOM; }
	else if (strcmp(dbg_str, "RTC_ALDOW") == 0) { if (write) { RTC_ALDOW = value; } return RTC_ALDOW; }
	else if (strcmp(dbg_str, "RTC_ALDOY") == 0) { if (write) { RTC_ALDOY = value; } return RTC_ALDOY; }
	else if (strcmp(dbg_str, "RTC_ALMON") == 0) { if (write) { RTC_ALMON = value; } return RTC_ALMON; }
	else if (strcmp(dbg_str, "RTC_ALYEAR") == 0) { if (write) { RTC_ALYEAR = value; } return RTC_ALYEAR; }
	else if (strcmp(dbg_str, "RTC_PREINT") == 0) { if (write) { RTC_PREINT = value; } return RTC_PREINT; }
	else if (strcmp(dbg_str, "RTC_PREFRAC") == 0) { if (write) { RTC_PREFRAC = value; } return RTC_PREFRAC; }
	else if (strcmp(dbg_str, "AD0_BASE_ADDR") == 0) { if (write) { return ERR_INVALID_PARAM; } return AD0_BASE_ADDR; }
	else if (strcmp(dbg_str, "AD0CR") == 0) { if (write) { AD0CR = value; } return AD0CR; }
	else if (strcmp(dbg_str, "AD0GDR") == 0) { if (write) { AD0GDR = value; } return AD0GDR; }
	else if (strcmp(dbg_str, "AD0INTEN") == 0) { if (write) { AD0INTEN = value; } return AD0INTEN; }
	else if (strcmp(dbg_str, "AD0DR0") == 0) { if (write) { AD0DR0 = value; } return AD0DR0; }
	else if (strcmp(dbg_str, "AD0DR1") == 0) { if (write) { AD0DR1 = value; } return AD0DR1; }
	else if (strcmp(dbg_str, "AD0DR2") == 0) { if (write) { AD0DR2 = value; } return AD0DR2; }
	else if (strcmp(dbg_str, "AD0DR3") == 0) { if (write) { AD0DR3 = value; } return AD0DR3; }
	else if (strcmp(dbg_str, "AD0DR4") == 0) { if (write) { AD0DR4 = value; } return AD0DR4; }
	else if (strcmp(dbg_str, "AD0DR5") == 0) { if (write) { AD0DR5 = value; } return AD0DR5; }
	else if (strcmp(dbg_str, "AD0DR6") == 0) { if (write) { AD0DR6 = value; } return AD0DR6; }
	else if (strcmp(dbg_str, "AD0DR7") == 0) { if (write) { AD0DR7 = value; } return AD0DR7; }
	else if (strcmp(dbg_str, "AD0STAT") == 0) { if (write) { AD0STAT = value; } return AD0STAT; }
	else if (strcmp(dbg_str, "DAC_BASE_ADDR") == 0) { if (write) { return ERR_INVALID_PARAM; } return DAC_BASE_ADDR; }
	else if (strcmp(dbg_str, "DACR") == 0) { if (write) { DACR = value; } return DACR; }
	else if (strcmp(dbg_str, "WDG_BASE_ADDR") == 0) { if (write) { return ERR_INVALID_PARAM; } return WDG_BASE_ADDR; }
	else if (strcmp(dbg_str, "WDMOD") == 0) { if (write) { WDMOD = value; } return WDMOD; }
	else if (strcmp(dbg_str, "WDTC") == 0) { if (write) { WDTC = value; } return WDTC; }
	else if (strcmp(dbg_str, "WDFEED") == 0) { if (write) { WDFEED = value; } return WDFEED; }
	else if (strcmp(dbg_str, "WDTV") == 0) { if (write) { WDTV = value; } return WDTV; }
	else if (strcmp(dbg_str, "WDCLKSEL") == 0) { if (write) { WDCLKSEL = value; } return WDCLKSEL; }
	else if (strcmp(dbg_str, "CAN_ACCEPT_BASE_ADDR") == 0) { if (write) { return ERR_INVALID_PARAM; } return CAN_ACCEPT_BASE_ADDR; }
	else if (strcmp(dbg_str, "CAN_AFMR") == 0) { if (write) { CAN_AFMR = value; } return CAN_AFMR; }
	else if (strcmp(dbg_str, "CAN_SFF_SA") == 0) { if (write) { CAN_SFF_SA = value; } return CAN_SFF_SA; }
	else if (strcmp(dbg_str, "CAN_SFF_GRP_SA") == 0) { if (write) { CAN_SFF_GRP_SA = value; } return CAN_SFF_GRP_SA; }
	else if (strcmp(dbg_str, "CAN_EFF_SA") == 0) { if (write) { CAN_EFF_SA = value; } return CAN_EFF_SA; }
	else if (strcmp(dbg_str, "CAN_EFF_GRP_SA") == 0) { if (write) { CAN_EFF_GRP_SA = value; } return CAN_EFF_GRP_SA; }
	else if (strcmp(dbg_str, "CAN_EOT") == 0) { if (write) { CAN_EOT = value; } return CAN_EOT; }
	else if (strcmp(dbg_str, "CAN_LUT_ERR_ADR") == 0) { if (write) { CAN_LUT_ERR_ADR = value; } return CAN_LUT_ERR_ADR; }
	else if (strcmp(dbg_str, "CAN_LUT_ERR") == 0) { if (write) { CAN_LUT_ERR = value; } return CAN_LUT_ERR; }
	else if (strcmp(dbg_str, "CAN_CENTRAL_BASE_ADDR") == 0) { if (write) { return ERR_INVALID_PARAM; } return CAN_CENTRAL_BASE_ADDR; }
	else if (strcmp(dbg_str, "CAN_TX_SR") == 0) { if (write) { CAN_TX_SR = value; } return CAN_TX_SR; }
	else if (strcmp(dbg_str, "CAN_RX_SR") == 0) { if (write) { CAN_RX_SR = value; } return CAN_RX_SR; }
	else if (strcmp(dbg_str, "CAN_MSR") == 0) { if (write) { CAN_MSR = value; } return CAN_MSR; }
	else if (strcmp(dbg_str, "CAN1_BASE_ADDR") == 0) { if (write) { return ERR_INVALID_PARAM; } return CAN1_BASE_ADDR; }
	else if (strcmp(dbg_str, "CAN1MOD") == 0) { if (write) { CAN1MOD = value; } return CAN1MOD; }
	else if (strcmp(dbg_str, "CAN1CMR") == 0) { if (write) { CAN1CMR = value; } return CAN1CMR; }
	else if (strcmp(dbg_str, "CAN1GSR") == 0) { if (write) { CAN1GSR = value; } return CAN1GSR; }
	else if (strcmp(dbg_str, "CAN1ICR") == 0) { if (write) { CAN1ICR = value; } return CAN1ICR; }
	else if (strcmp(dbg_str, "CAN1IER") == 0) { if (write) { CAN1IER = value; } return CAN1IER; }
	else if (strcmp(dbg_str, "CAN1BTR") == 0) { if (write) { CAN1BTR = value; } return CAN1BTR; }
	else if (strcmp(dbg_str, "CAN1EWL") == 0) { if (write) { CAN1EWL = value; } return CAN1EWL; }
	else if (strcmp(dbg_str, "CAN1SR") == 0) { if (write) { CAN1SR = value; } return CAN1SR; }
	else if (strcmp(dbg_str, "CAN1RFS") == 0) { if (write) { CAN1RFS = value; } return CAN1RFS; }
	else if (strcmp(dbg_str, "CAN1RID") == 0) { if (write) { CAN1RID = value; } return CAN1RID; }
	else if (strcmp(dbg_str, "CAN1RDA") == 0) { if (write) { CAN1RDA = value; } return CAN1RDA; }
	else if (strcmp(dbg_str, "CAN1RDB") == 0) { if (write) { CAN1RDB = value; } return CAN1RDB; }
	else if (strcmp(dbg_str, "CAN1TFI1") == 0) { if (write) { CAN1TFI1 = value; } return CAN1TFI1; }
	else if (strcmp(dbg_str, "CAN1TID1") == 0) { if (write) { CAN1TID1 = value; } return CAN1TID1; }
	else if (strcmp(dbg_str, "CAN1TDA1") == 0) { if (write) { CAN1TDA1 = value; } return CAN1TDA1; }
	else if (strcmp(dbg_str, "CAN1TDB1") == 0) { if (write) { CAN1TDB1 = value; } return CAN1TDB1; }
	else if (strcmp(dbg_str, "CAN1TFI2") == 0) { if (write) { CAN1TFI2 = value; } return CAN1TFI2; }
	else if (strcmp(dbg_str, "CAN1TID2") == 0) { if (write) { CAN1TID2 = value; } return CAN1TID2; }
	else if (strcmp(dbg_str, "CAN1TDA2") == 0) { if (write) { CAN1TDA2 = value; } return CAN1TDA2; }
	else if (strcmp(dbg_str, "CAN1TDB2") == 0) { if (write) { CAN1TDB2 = value; } return CAN1TDB2; }
	else if (strcmp(dbg_str, "CAN1TFI3") == 0) { if (write) { CAN1TFI3 = value; } return CAN1TFI3; }
	else if (strcmp(dbg_str, "CAN1TID3") == 0) { if (write) { CAN1TID3 = value; } return CAN1TID3; }
	else if (strcmp(dbg_str, "CAN1TDA3") == 0) { if (write) { CAN1TDA3 = value; } return CAN1TDA3; }
	else if (strcmp(dbg_str, "CAN1TDB3") == 0) { if (write) { CAN1TDB3 = value; } return CAN1TDB3; }
	else if (strcmp(dbg_str, "CAN2_BASE_ADDR") == 0) { if (write) { return ERR_INVALID_PARAM; } return CAN2_BASE_ADDR; }
	else if (strcmp(dbg_str, "CAN2MOD") == 0) { if (write) { CAN2MOD = value; } return CAN2MOD; }
	else if (strcmp(dbg_str, "CAN2CMR") == 0) { if (write) { CAN2CMR = value; } return CAN2CMR; }
	else if (strcmp(dbg_str, "CAN2GSR") == 0) { if (write) { CAN2GSR = value; } return CAN2GSR; }
	else if (strcmp(dbg_str, "CAN2ICR") == 0) { if (write) { CAN2ICR = value; } return CAN2ICR; }
	else if (strcmp(dbg_str, "CAN2IER") == 0) { if (write) { CAN2IER = value; } return CAN2IER; }
	else if (strcmp(dbg_str, "CAN2BTR") == 0) { if (write) { CAN2BTR = value; } return CAN2BTR; }
	else if (strcmp(dbg_str, "CAN2EWL") == 0) { if (write) { CAN2EWL = value; } return CAN2EWL; }
	else if (strcmp(dbg_str, "CAN2SR") == 0) { if (write) { CAN2SR = value; } return CAN2SR; }
	else if (strcmp(dbg_str, "CAN2RFS") == 0) { if (write) { CAN2RFS = value; } return CAN2RFS; }
	else if (strcmp(dbg_str, "CAN2RID") == 0) { if (write) { CAN2RID = value; } return CAN2RID; }
	else if (strcmp(dbg_str, "CAN2RDA") == 0) { if (write) { CAN2RDA = value; } return CAN2RDA; }
	else if (strcmp(dbg_str, "CAN2RDB") == 0) { if (write) { CAN2RDB = value; } return CAN2RDB; }
	else if (strcmp(dbg_str, "CAN2TFI1") == 0) { if (write) { CAN2TFI1 = value; } return CAN2TFI1; }
	else if (strcmp(dbg_str, "CAN2TID1") == 0) { if (write) { CAN2TID1 = value; } return CAN2TID1; }
	else if (strcmp(dbg_str, "CAN2TDA1") == 0) { if (write) { CAN2TDA1 = value; } return CAN2TDA1; }
	else if (strcmp(dbg_str, "CAN2TDB1") == 0) { if (write) { CAN2TDB1 = value; } return CAN2TDB1; }
	else if (strcmp(dbg_str, "CAN2TFI2") == 0) { if (write) { CAN2TFI2 = value; } return CAN2TFI2; }
	else if (strcmp(dbg_str, "CAN2TID2") == 0) { if (write) { CAN2TID2 = value; } return CAN2TID2; }
	else if (strcmp(dbg_str, "CAN2TDA2") == 0) { if (write) { CAN2TDA2 = value; } return CAN2TDA2; }
	else if (strcmp(dbg_str, "CAN2TDB2") == 0) { if (write) { CAN2TDB2 = value; } return CAN2TDB2; }
	else if (strcmp(dbg_str, "CAN2TFI3") == 0) { if (write) { CAN2TFI3 = value; } return CAN2TFI3; }
	else if (strcmp(dbg_str, "CAN2TID3") == 0) { if (write) { CAN2TID3 = value; } return CAN2TID3; }
	else if (strcmp(dbg_str, "CAN2TDA3") == 0) { if (write) { CAN2TDA3 = value; } return CAN2TDA3; }
	else if (strcmp(dbg_str, "CAN2TDB3") == 0) { if (write) { CAN2TDB3 = value; } return CAN2TDB3; }
	else if (strcmp(dbg_str, "MCI_BASE_ADDR") == 0) { if (write) { return ERR_INVALID_PARAM; } return MCI_BASE_ADDR; }
	else if (strcmp(dbg_str, "MCI_POWER") == 0) { if (write) { MCI_POWER = value; } return MCI_POWER; }
	else if (strcmp(dbg_str, "MCI_CLOCK") == 0) { if (write) { MCI_CLOCK = value; } return MCI_CLOCK; }
	else if (strcmp(dbg_str, "MCI_ARGUMENT") == 0) { if (write) { MCI_ARGUMENT = value; } return MCI_ARGUMENT; }
	else if (strcmp(dbg_str, "MCI_COMMAND") == 0) { if (write) { MCI_COMMAND = value; } return MCI_COMMAND; }
	else if (strcmp(dbg_str, "MCI_RESP_CMD") == 0) { if (write) { MCI_RESP_CMD = value; } return MCI_RESP_CMD; }
	else if (strcmp(dbg_str, "MCI_RESP0") == 0) { if (write) { MCI_RESP0 = value; } return MCI_RESP0; }
	else if (strcmp(dbg_str, "MCI_RESP1") == 0) { if (write) { MCI_RESP1 = value; } return MCI_RESP1; }
	else if (strcmp(dbg_str, "MCI_RESP2") == 0) { if (write) { MCI_RESP2 = value; } return MCI_RESP2; }
	else if (strcmp(dbg_str, "MCI_RESP3") == 0) { if (write) { MCI_RESP3 = value; } return MCI_RESP3; }
	else if (strcmp(dbg_str, "MCI_DATA_TMR") == 0) { if (write) { MCI_DATA_TMR = value; } return MCI_DATA_TMR; }
	else if (strcmp(dbg_str, "MCI_DATA_LEN") == 0) { if (write) { MCI_DATA_LEN = value; } return MCI_DATA_LEN; }
	else if (strcmp(dbg_str, "MCI_DATA_CTRL") == 0) { if (write) { MCI_DATA_CTRL = value; } return MCI_DATA_CTRL; }
	else if (strcmp(dbg_str, "MCI_DATA_CNT") == 0) { if (write) { MCI_DATA_CNT = value; } return MCI_DATA_CNT; }
	else if (strcmp(dbg_str, "MCI_STATUS") == 0) { if (write) { MCI_STATUS = value; } return MCI_STATUS; }
	else if (strcmp(dbg_str, "MCI_CLEAR") == 0) { if (write) { MCI_CLEAR = value; } return MCI_CLEAR; }
	else if (strcmp(dbg_str, "MCI_MASK0") == 0) { if (write) { MCI_MASK0 = value; } return MCI_MASK0; }
	else if (strcmp(dbg_str, "MCI_MASK1") == 0) { if (write) { MCI_MASK1 = value; } return MCI_MASK1; }
	else if (strcmp(dbg_str, "MCI_FIFO_CNT") == 0) { if (write) { MCI_FIFO_CNT = value; } return MCI_FIFO_CNT; }
	else if (strcmp(dbg_str, "MCI_FIFO") == 0) { if (write) { MCI_FIFO = value; } return MCI_FIFO; }
	else if (strcmp(dbg_str, "I2S_BASE_ADDR") == 0) { if (write) { return ERR_INVALID_PARAM; } return I2S_BASE_ADDR; }
	else if (strcmp(dbg_str, "I2S_DAO") == 0) { if (write) { I2S_DAO = value; } return I2S_DAO; }
	else if (strcmp(dbg_str, "I2S_DAI") == 0) { if (write) { I2S_DAI = value; } return I2S_DAI; }
	else if (strcmp(dbg_str, "I2S_TX_FIFO") == 0) { if (write) { I2S_TX_FIFO = value; } return I2S_TX_FIFO; }
	else if (strcmp(dbg_str, "I2S_RX_FIFO") == 0) { if (write) { I2S_RX_FIFO = value; } return I2S_RX_FIFO; }
	else if (strcmp(dbg_str, "I2S_STATE") == 0) { if (write) { I2S_STATE = value; } return I2S_STATE; }
	else if (strcmp(dbg_str, "I2S_DMA1") == 0) { if (write) { I2S_DMA1 = value; } return I2S_DMA1; }
	else if (strcmp(dbg_str, "I2S_DMA2") == 0) { if (write) { I2S_DMA2 = value; } return I2S_DMA2; }
	else if (strcmp(dbg_str, "I2S_IRQ") == 0) { if (write) { I2S_IRQ = value; } return I2S_IRQ; }
	else if (strcmp(dbg_str, "I2S_TXRATE") == 0) { if (write) { I2S_TXRATE = value; } return I2S_TXRATE; }
	else if (strcmp(dbg_str, "I2S_RXRATE") == 0) { if (write) { I2S_RXRATE = value; } return I2S_RXRATE; }
	else if (strcmp(dbg_str, "DMA_BASE_ADDR") == 0) { if (write) { return ERR_INVALID_PARAM; } return DMA_BASE_ADDR; }
	else if (strcmp(dbg_str, "GPDMA_INT_STAT") == 0) { if (write) { GPDMA_INT_STAT = value; } return GPDMA_INT_STAT; }
	else if (strcmp(dbg_str, "GPDMA_INT_TCSTAT") == 0) { if (write) { GPDMA_INT_TCSTAT = value; } return GPDMA_INT_TCSTAT; }
	else if (strcmp(dbg_str, "GPDMA_INT_TCCLR") == 0) { if (write) { GPDMA_INT_TCCLR = value; } return GPDMA_INT_TCCLR; }
	else if (strcmp(dbg_str, "GPDMA_INT_ERR_STAT") == 0) { if (write) { GPDMA_INT_ERR_STAT = value; } return GPDMA_INT_ERR_STAT; }
	else if (strcmp(dbg_str, "GPDMA_INT_ERR_CLR") == 0) { if (write) { GPDMA_INT_ERR_CLR = value; } return GPDMA_INT_ERR_CLR; }
	else if (strcmp(dbg_str, "GPDMA_RAW_INT_TCSTAT") == 0) { if (write) { GPDMA_RAW_INT_TCSTAT = value; } return GPDMA_RAW_INT_TCSTAT; }
	else if (strcmp(dbg_str, "GPDMA_RAW_INT_ERR_STAT") == 0) { if (write) { GPDMA_RAW_INT_ERR_STAT = value; } return GPDMA_RAW_INT_ERR_STAT; }
	else if (strcmp(dbg_str, "GPDMA_ENABLED_CHNS") == 0) { if (write) { GPDMA_ENABLED_CHNS = value; } return GPDMA_ENABLED_CHNS; }
	else if (strcmp(dbg_str, "GPDMA_SOFT_BREQ") == 0) { if (write) { GPDMA_SOFT_BREQ = value; } return GPDMA_SOFT_BREQ; }
	else if (strcmp(dbg_str, "GPDMA_SOFT_SREQ") == 0) { if (write) { GPDMA_SOFT_SREQ = value; } return GPDMA_SOFT_SREQ; }
	else if (strcmp(dbg_str, "GPDMA_SOFT_LBREQ") == 0) { if (write) { GPDMA_SOFT_LBREQ = value; } return GPDMA_SOFT_LBREQ; }
	else if (strcmp(dbg_str, "GPDMA_SOFT_LSREQ") == 0) { if (write) { GPDMA_SOFT_LSREQ = value; } return GPDMA_SOFT_LSREQ; }
	else if (strcmp(dbg_str, "GPDMA_CONFIG") == 0) { if (write) { GPDMA_CONFIG = value; } return GPDMA_CONFIG; }
	else if (strcmp(dbg_str, "GPDMA_SYNC") == 0) { if (write) { GPDMA_SYNC = value; } return GPDMA_SYNC; }
	else if (strcmp(dbg_str, "GPDMA_CH0_SRC") == 0) { if (write) { GPDMA_CH0_SRC = value; } return GPDMA_CH0_SRC; }
	else if (strcmp(dbg_str, "GPDMA_CH0_DEST") == 0) { if (write) { GPDMA_CH0_DEST = value; } return GPDMA_CH0_DEST; }
	else if (strcmp(dbg_str, "GPDMA_CH0_LLI") == 0) { if (write) { GPDMA_CH0_LLI = value; } return GPDMA_CH0_LLI; }
	else if (strcmp(dbg_str, "GPDMA_CH0_CTRL") == 0) { if (write) { GPDMA_CH0_CTRL = value; } return GPDMA_CH0_CTRL; }
	else if (strcmp(dbg_str, "GPDMA_CH0_CFG") == 0) { if (write) { GPDMA_CH0_CFG = value; } return GPDMA_CH0_CFG; }
	else if (strcmp(dbg_str, "GPDMA_CH1_SRC") == 0) { if (write) { GPDMA_CH1_SRC = value; } return GPDMA_CH1_SRC; }
	else if (strcmp(dbg_str, "GPDMA_CH1_DEST") == 0) { if (write) { GPDMA_CH1_DEST = value; } return GPDMA_CH1_DEST; }
	else if (strcmp(dbg_str, "GPDMA_CH1_LLI") == 0) { if (write) { GPDMA_CH1_LLI = value; } return GPDMA_CH1_LLI; }
	else if (strcmp(dbg_str, "GPDMA_CH1_CTRL") == 0) { if (write) { GPDMA_CH1_CTRL = value; } return GPDMA_CH1_CTRL; }
	else if (strcmp(dbg_str, "GPDMA_CH1_CFG") == 0) { if (write) { GPDMA_CH1_CFG = value; } return GPDMA_CH1_CFG; }
	else if (strcmp(dbg_str, "USB_INT_BASE_ADDR") == 0) { if (write) { return ERR_INVALID_PARAM; } return USB_INT_BASE_ADDR; }
	else if (strcmp(dbg_str, "USB_BASE_ADDR") == 0) { if (write) { return ERR_INVALID_PARAM; } return USB_BASE_ADDR; }
	else if (strcmp(dbg_str, "USB_INT_STAT") == 0) { if (write) { USB_INT_STAT = value; } return USB_INT_STAT; }
	else if (strcmp(dbg_str, "DEV_INT_STAT") == 0) { if (write) { DEV_INT_STAT = value; } return DEV_INT_STAT; }
	else if (strcmp(dbg_str, "DEV_INT_EN") == 0) { if (write) { DEV_INT_EN = value; } return DEV_INT_EN; }
	else if (strcmp(dbg_str, "DEV_INT_CLR") == 0) { if (write) { DEV_INT_CLR = value; } return DEV_INT_CLR; }
	else if (strcmp(dbg_str, "DEV_INT_SET") == 0) { if (write) { DEV_INT_SET = value; } return DEV_INT_SET; }
	else if (strcmp(dbg_str, "DEV_INT_PRIO") == 0) { if (write) { DEV_INT_PRIO = value; } return DEV_INT_PRIO; }
	else if (strcmp(dbg_str, "EP_INT_STAT") == 0) { if (write) { EP_INT_STAT = value; } return EP_INT_STAT; }
	else if (strcmp(dbg_str, "EP_INT_EN") == 0) { if (write) { EP_INT_EN = value; } return EP_INT_EN; }
	else if (strcmp(dbg_str, "EP_INT_CLR") == 0) { if (write) { EP_INT_CLR = value; } return EP_INT_CLR; }
	else if (strcmp(dbg_str, "EP_INT_SET") == 0) { if (write) { EP_INT_SET = value; } return EP_INT_SET; }
	else if (strcmp(dbg_str, "EP_INT_PRIO") == 0) { if (write) { EP_INT_PRIO = value; } return EP_INT_PRIO; }
	else if (strcmp(dbg_str, "REALIZE_EP") == 0) { if (write) { REALIZE_EP = value; } return REALIZE_EP; }
	else if (strcmp(dbg_str, "EP_INDEX") == 0) { if (write) { EP_INDEX = value; } return EP_INDEX; }
	else if (strcmp(dbg_str, "MAXPACKET_SIZE") == 0) { if (write) { MAXPACKET_SIZE = value; } return MAXPACKET_SIZE; }
	else if (strcmp(dbg_str, "CMD_CODE") == 0) { if (write) { CMD_CODE = value; } return CMD_CODE; }
	else if (strcmp(dbg_str, "CMD_DATA") == 0) { if (write) { CMD_DATA = value; } return CMD_DATA; }
	else if (strcmp(dbg_str, "RX_DATA") == 0) { if (write) { RX_DATA = value; } return RX_DATA; }
	else if (strcmp(dbg_str, "TX_DATA") == 0) { if (write) { TX_DATA = value; } return TX_DATA; }
	else if (strcmp(dbg_str, "RX_PLENGTH") == 0) { if (write) { RX_PLENGTH = value; } return RX_PLENGTH; }
	else if (strcmp(dbg_str, "TX_PLENGTH") == 0) { if (write) { TX_PLENGTH = value; } return TX_PLENGTH; }
	else if (strcmp(dbg_str, "USB_CTRL") == 0) { if (write) { USB_CTRL = value; } return USB_CTRL; }
	else if (strcmp(dbg_str, "DMA_REQ_STAT") == 0) { if (write) { DMA_REQ_STAT = value; } return DMA_REQ_STAT; }
	else if (strcmp(dbg_str, "DMA_REQ_CLR") == 0) { if (write) { DMA_REQ_CLR = value; } return DMA_REQ_CLR; }
	else if (strcmp(dbg_str, "DMA_REQ_SET") == 0) { if (write) { DMA_REQ_SET = value; } return DMA_REQ_SET; }
	else if (strcmp(dbg_str, "UDCA_HEAD") == 0) { if (write) { UDCA_HEAD = value; } return UDCA_HEAD; }
	else if (strcmp(dbg_str, "EP_DMA_STAT") == 0) { if (write) { EP_DMA_STAT = value; } return EP_DMA_STAT; }
	else if (strcmp(dbg_str, "EP_DMA_EN") == 0) { if (write) { EP_DMA_EN = value; } return EP_DMA_EN; }
	else if (strcmp(dbg_str, "EP_DMA_DIS") == 0) { if (write) { EP_DMA_DIS = value; } return EP_DMA_DIS; }
	else if (strcmp(dbg_str, "DMA_INT_STAT") == 0) { if (write) { DMA_INT_STAT = value; } return DMA_INT_STAT; }
	else if (strcmp(dbg_str, "DMA_INT_EN") == 0) { if (write) { DMA_INT_EN = value; } return DMA_INT_EN; }
	else if (strcmp(dbg_str, "EOT_INT_STAT") == 0) { if (write) { EOT_INT_STAT = value; } return EOT_INT_STAT; }
	else if (strcmp(dbg_str, "EOT_INT_CLR") == 0) { if (write) { EOT_INT_CLR = value; } return EOT_INT_CLR; }
	else if (strcmp(dbg_str, "EOT_INT_SET") == 0) { if (write) { EOT_INT_SET = value; } return EOT_INT_SET; }
	else if (strcmp(dbg_str, "NDD_REQ_INT_STAT") == 0) { if (write) { NDD_REQ_INT_STAT = value; } return NDD_REQ_INT_STAT; }
	else if (strcmp(dbg_str, "NDD_REQ_INT_CLR") == 0) { if (write) { NDD_REQ_INT_CLR = value; } return NDD_REQ_INT_CLR; }
	else if (strcmp(dbg_str, "NDD_REQ_INT_SET") == 0) { if (write) { NDD_REQ_INT_SET = value; } return NDD_REQ_INT_SET; }
	else if (strcmp(dbg_str, "SYS_ERR_INT_STAT") == 0) { if (write) { SYS_ERR_INT_STAT = value; } return SYS_ERR_INT_STAT; }
	else if (strcmp(dbg_str, "SYS_ERR_INT_CLR") == 0) { if (write) { SYS_ERR_INT_CLR = value; } return SYS_ERR_INT_CLR; }
	else if (strcmp(dbg_str, "SYS_ERR_INT_SET") == 0) { if (write) { SYS_ERR_INT_SET = value; } return SYS_ERR_INT_SET; }
	else if (strcmp(dbg_str, "USBHC_BASE_ADDR") == 0) { if (write) { return ERR_INVALID_PARAM; } return USBHC_BASE_ADDR; }
	else if (strcmp(dbg_str, "HC_REVISION") == 0) { if (write) { HC_REVISION = value; } return HC_REVISION; }
	else if (strcmp(dbg_str, "HC_CONTROL") == 0) { if (write) { HC_CONTROL = value; } return HC_CONTROL; }
	else if (strcmp(dbg_str, "HC_CMD_STAT") == 0) { if (write) { HC_CMD_STAT = value; } return HC_CMD_STAT; }
	else if (strcmp(dbg_str, "HC_INT_STAT") == 0) { if (write) { HC_INT_STAT = value; } return HC_INT_STAT; }
	else if (strcmp(dbg_str, "HC_INT_EN") == 0) { if (write) { HC_INT_EN = value; } return HC_INT_EN; }
	else if (strcmp(dbg_str, "HC_INT_DIS") == 0) { if (write) { HC_INT_DIS = value; } return HC_INT_DIS; }
	else if (strcmp(dbg_str, "HC_HCCA") == 0) { if (write) { HC_HCCA = value; } return HC_HCCA; }
	else if (strcmp(dbg_str, "HC_PERIOD_CUR_ED") == 0) { if (write) { HC_PERIOD_CUR_ED = value; } return HC_PERIOD_CUR_ED; }
	else if (strcmp(dbg_str, "HC_CTRL_HEAD_ED") == 0) { if (write) { HC_CTRL_HEAD_ED = value; } return HC_CTRL_HEAD_ED; }
	else if (strcmp(dbg_str, "HC_CTRL_CUR_ED") == 0) { if (write) { HC_CTRL_CUR_ED = value; } return HC_CTRL_CUR_ED; }
	else if (strcmp(dbg_str, "HC_BULK_HEAD_ED") == 0) { if (write) { HC_BULK_HEAD_ED = value; } return HC_BULK_HEAD_ED; }
	else if (strcmp(dbg_str, "HC_BULK_CUR_ED") == 0) { if (write) { HC_BULK_CUR_ED = value; } return HC_BULK_CUR_ED; }
	else if (strcmp(dbg_str, "HC_DONE_HEAD") == 0) { if (write) { HC_DONE_HEAD = value; } return HC_DONE_HEAD; }
	else if (strcmp(dbg_str, "HC_FM_INTERVAL") == 0) { if (write) { HC_FM_INTERVAL = value; } return HC_FM_INTERVAL; }
	else if (strcmp(dbg_str, "HC_FM_REMAINING") == 0) { if (write) { HC_FM_REMAINING = value; } return HC_FM_REMAINING; }
	else if (strcmp(dbg_str, "HC_FM_NUMBER") == 0) { if (write) { HC_FM_NUMBER = value; } return HC_FM_NUMBER; }
	else if (strcmp(dbg_str, "HC_PERIOD_START") == 0) { if (write) { HC_PERIOD_START = value; } return HC_PERIOD_START; }
	else if (strcmp(dbg_str, "HC_LS_THRHLD") == 0) { if (write) { HC_LS_THRHLD = value; } return HC_LS_THRHLD; }
	else if (strcmp(dbg_str, "HC_RH_DESCA") == 0) { if (write) { HC_RH_DESCA = value; } return HC_RH_DESCA; }
	else if (strcmp(dbg_str, "HC_RH_DESCB") == 0) { if (write) { HC_RH_DESCB = value; } return HC_RH_DESCB; }
	else if (strcmp(dbg_str, "HC_RH_STAT") == 0) { if (write) { HC_RH_STAT = value; } return HC_RH_STAT; }
	else if (strcmp(dbg_str, "HC_RH_PORT_STAT1") == 0) { if (write) { HC_RH_PORT_STAT1 = value; } return HC_RH_PORT_STAT1; }
	else if (strcmp(dbg_str, "HC_RH_PORT_STAT2") == 0) { if (write) { HC_RH_PORT_STAT2 = value; } return HC_RH_PORT_STAT2; }
	else if (strcmp(dbg_str, "USBOTG_BASE_ADDR") == 0) { if (write) { return ERR_INVALID_PARAM; } return USBOTG_BASE_ADDR; }
	else if (strcmp(dbg_str, "OTG_INT_STAT") == 0) { if (write) { OTG_INT_STAT = value; } return OTG_INT_STAT; }
	else if (strcmp(dbg_str, "OTG_INT_EN") == 0) { if (write) { OTG_INT_EN = value; } return OTG_INT_EN; }
	else if (strcmp(dbg_str, "OTG_INT_SET") == 0) { if (write) { OTG_INT_SET = value; } return OTG_INT_SET; }
	else if (strcmp(dbg_str, "OTG_INT_CLR") == 0) { if (write) { OTG_INT_CLR = value; } return OTG_INT_CLR; }
	else if (strcmp(dbg_str, "OTG_STAT_CTRL") == 0) { if (write) { OTG_STAT_CTRL = value; } return OTG_STAT_CTRL; }
	else if (strcmp(dbg_str, "OTG_TIMER") == 0) { if (write) { OTG_TIMER = value; } return OTG_TIMER; }
	else if (strcmp(dbg_str, "USBOTG_I2C_BASE_ADDR") == 0) { if (write) { return ERR_INVALID_PARAM; } return USBOTG_I2C_BASE_ADDR; }
	else if (strcmp(dbg_str, "OTG_I2C_RX") == 0) { if (write) { OTG_I2C_RX = value; } return OTG_I2C_RX; }
	else if (strcmp(dbg_str, "OTG_I2C_TX") == 0) { if (write) { OTG_I2C_TX = value; } return OTG_I2C_TX; }
	else if (strcmp(dbg_str, "OTG_I2C_STS") == 0) { if (write) { OTG_I2C_STS = value; } return OTG_I2C_STS; }
	else if (strcmp(dbg_str, "OTG_I2C_CTL") == 0) { if (write) { OTG_I2C_CTL = value; } return OTG_I2C_CTL; }
	else if (strcmp(dbg_str, "OTG_I2C_CLKHI") == 0) { if (write) { OTG_I2C_CLKHI = value; } return OTG_I2C_CLKHI; }
	else if (strcmp(dbg_str, "OTG_I2C_CLKLO") == 0) { if (write) { OTG_I2C_CLKLO = value; } return OTG_I2C_CLKLO; }
	else if (strcmp(dbg_str, "USBOTG_CLK_BASE_ADDR") == 0) { if (write) { return ERR_INVALID_PARAM; } return USBOTG_CLK_BASE_ADDR; }
	else if (strcmp(dbg_str, "OTG_CLK_CTRL") == 0) { if (write) { OTG_CLK_CTRL = value; } return OTG_CLK_CTRL; }
	else if (strcmp(dbg_str, "OTG_CLK_STAT") == 0) { if (write) { OTG_CLK_STAT = value; } return OTG_CLK_STAT; }
	else if (strcmp(dbg_str, "MAC_BASE_ADDR") == 0) { if (write) { return ERR_INVALID_PARAM; } return MAC_BASE_ADDR; }
	else if (strcmp(dbg_str, "MAC_MAC1") == 0) { if (write) { MAC_MAC1 = value; } return MAC_MAC1; }
	else if (strcmp(dbg_str, "MAC_MAC2") == 0) { if (write) { MAC_MAC2 = value; } return MAC_MAC2; }
	else if (strcmp(dbg_str, "MAC_IPGT") == 0) { if (write) { MAC_IPGT = value; } return MAC_IPGT; }
	else if (strcmp(dbg_str, "MAC_IPGR") == 0) { if (write) { MAC_IPGR = value; } return MAC_IPGR; }
	else if (strcmp(dbg_str, "MAC_CLRT") == 0) { if (write) { MAC_CLRT = value; } return MAC_CLRT; }
	else if (strcmp(dbg_str, "MAC_MAXF") == 0) { if (write) { MAC_MAXF = value; } return MAC_MAXF; }
	else if (strcmp(dbg_str, "MAC_SUPP") == 0) { if (write) { MAC_SUPP = value; } return MAC_SUPP; }
	else if (strcmp(dbg_str, "MAC_TEST") == 0) { if (write) { MAC_TEST = value; } return MAC_TEST; }
	else if (strcmp(dbg_str, "MAC_MCFG") == 0) { if (write) { MAC_MCFG = value; } return MAC_MCFG; }
	else if (strcmp(dbg_str, "MAC_MCMD") == 0) { if (write) { MAC_MCMD = value; } return MAC_MCMD; }
	else if (strcmp(dbg_str, "MAC_MADR") == 0) { if (write) { MAC_MADR = value; } return MAC_MADR; }
	else if (strcmp(dbg_str, "MAC_MWTD") == 0) { if (write) { MAC_MWTD = value; } return MAC_MWTD; }
	else if (strcmp(dbg_str, "MAC_MRDD") == 0) { if (write) { MAC_MRDD = value; } return MAC_MRDD; }
	else if (strcmp(dbg_str, "MAC_MIND") == 0) { if (write) { MAC_MIND = value; } return MAC_MIND; }
	else if (strcmp(dbg_str, "MAC_SA0") == 0) { if (write) { MAC_SA0 = value; } return MAC_SA0; }
	else if (strcmp(dbg_str, "MAC_SA1") == 0) { if (write) { MAC_SA1 = value; } return MAC_SA1; }
	else if (strcmp(dbg_str, "MAC_SA2") == 0) { if (write) { MAC_SA2 = value; } return MAC_SA2; }
	else if (strcmp(dbg_str, "MAC_COMMAND") == 0) { if (write) { MAC_COMMAND = value; } return MAC_COMMAND; }
	else if (strcmp(dbg_str, "MAC_STATUS") == 0) { if (write) { MAC_STATUS = value; } return MAC_STATUS; }
	else if (strcmp(dbg_str, "MAC_RXDESCRIPTOR") == 0) { if (write) { MAC_RXDESCRIPTOR = value; } return MAC_RXDESCRIPTOR; }
	else if (strcmp(dbg_str, "MAC_RXSTATUS") == 0) { if (write) { MAC_RXSTATUS = value; } return MAC_RXSTATUS; }
	else if (strcmp(dbg_str, "MAC_RXDESCRIPTORNUM") == 0) { if (write) { MAC_RXDESCRIPTORNUM = value; } return MAC_RXDESCRIPTORNUM; }
	else if (strcmp(dbg_str, "MAC_RXPRODUCEINDEX") == 0) { if (write) { MAC_RXPRODUCEINDEX = value; } return MAC_RXPRODUCEINDEX; }
	else if (strcmp(dbg_str, "MAC_RXCONSUMEINDEX") == 0) { if (write) { MAC_RXCONSUMEINDEX = value; } return MAC_RXCONSUMEINDEX; }
	else if (strcmp(dbg_str, "MAC_TXDESCRIPTOR") == 0) { if (write) { MAC_TXDESCRIPTOR = value; } return MAC_TXDESCRIPTOR; }
	else if (strcmp(dbg_str, "MAC_TXSTATUS") == 0) { if (write) { MAC_TXSTATUS = value; } return MAC_TXSTATUS; }
	else if (strcmp(dbg_str, "MAC_TXDESCRIPTORNUM") == 0) { if (write) { MAC_TXDESCRIPTORNUM = value; } return MAC_TXDESCRIPTORNUM; }
	else if (strcmp(dbg_str, "MAC_TXPRODUCEINDEX") == 0) { if (write) { MAC_TXPRODUCEINDEX = value; } return MAC_TXPRODUCEINDEX; }
	else if (strcmp(dbg_str, "MAC_TXCONSUMEINDEX") == 0) { if (write) { MAC_TXCONSUMEINDEX = value; } return MAC_TXCONSUMEINDEX; }
	else if (strcmp(dbg_str, "MAC_TSV0") == 0) { if (write) { MAC_TSV0 = value; } return MAC_TSV0; }
	else if (strcmp(dbg_str, "MAC_TSV1") == 0) { if (write) { MAC_TSV1 = value; } return MAC_TSV1; }
	else if (strcmp(dbg_str, "MAC_RSV") == 0) { if (write) { MAC_RSV = value; } return MAC_RSV; }
	else if (strcmp(dbg_str, "MAC_FLOWCONTROLCNT") == 0) { if (write) { MAC_FLOWCONTROLCNT = value; } return MAC_FLOWCONTROLCNT; }
	else if (strcmp(dbg_str, "MAC_FLOWCONTROLSTS") == 0) { if (write) { MAC_FLOWCONTROLSTS = value; } return MAC_FLOWCONTROLSTS; }
	else if (strcmp(dbg_str, "MAC_RXFILTERCTRL") == 0) { if (write) { MAC_RXFILTERCTRL = value; } return MAC_RXFILTERCTRL; }
	else if (strcmp(dbg_str, "MAC_RXFILTERWOLSTS") == 0) { if (write) { MAC_RXFILTERWOLSTS = value; } return MAC_RXFILTERWOLSTS; }
	else if (strcmp(dbg_str, "MAC_RXFILTERWOLCLR") == 0) { if (write) { MAC_RXFILTERWOLCLR = value; } return MAC_RXFILTERWOLCLR; }
	else if (strcmp(dbg_str, "MAC_HASHFILTERL") == 0) { if (write) { MAC_HASHFILTERL = value; } return MAC_HASHFILTERL; }
	else if (strcmp(dbg_str, "MAC_HASHFILTERH") == 0) { if (write) { MAC_HASHFILTERH = value; } return MAC_HASHFILTERH; }
	else if (strcmp(dbg_str, "MAC_INTSTATUS") == 0) { if (write) { MAC_INTSTATUS = value; } return MAC_INTSTATUS; }
	else if (strcmp(dbg_str, "MAC_INTENABLE") == 0) { if (write) { MAC_INTENABLE = value; } return MAC_INTENABLE; }
	else if (strcmp(dbg_str, "MAC_INTCLEAR") == 0) { if (write) { MAC_INTCLEAR = value; } return MAC_INTCLEAR; }
	else if (strcmp(dbg_str, "MAC_INTSET") == 0) { if (write) { MAC_INTSET = value; } return MAC_INTSET; }
	else if (strcmp(dbg_str, "MAC_POWERDOWN") == 0) { if (write) { MAC_POWERDOWN = value; } return MAC_POWERDOWN; }
	else if (strcmp(dbg_str, "MAC_MODULEID") == 0) { if (write) { MAC_MODULEID = value; } return MAC_MODULEID; }
	else
#endif /* PC_COMPILATION */
		return ERR_INVALID_REG;

#endif /* DEBUG_MODE */
	return 0;
}
